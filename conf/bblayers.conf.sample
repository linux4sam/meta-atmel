## conf/bblayers.conf.sample
```bitbake
# POKY_BBLAYERS_CONF_VERSION is increased each time build/conf/bblayers.conf
# changes incompatibly
POKY_BBLAYERS_CONF_VERSION = "2"

BBPATH = "${TOPDIR}"
BBFILES ?= ""

BBLAYERS ?= " \
  ##OEROOT##/meta \
  ##OEROOT##/meta-poky \
  ##OEROOT##/meta-yocto-bsp \
  ##OEROOT##/../meta-openembedded/meta-oe \
  ##OEROOT##/../meta-openembedded/meta-networking \
  ##OEROOT##/../meta-openembedded/meta-python \
  ##OEROOT##/../meta-openembedded/meta-initramfs \
  ##OEROOT##/../meta-atmel \
  ##OEROOT##/../meta-openembedded/meta-multimedia \
  ##OEROOT##/../meta-aws \
  "
```

## conf/distro/poky-atmel.conf
```bitbake
require conf/distro/poky.conf

DISTRO = "poky-atmel"

DISTRO_FEATURES:remove ?= "opengl wayland vulkan x11 3g nfc pulseaudio"

DISTRO_FEATURES += "pam ppp"

# icu is needed to get egt
PACKAGECONFIG_DISTRO:pn-egt ?= "icu openssl freetype fontconfig"

EXTRA_OECONF:remove = "${DISABLE_STATIC}"
PREFERRED_VERSION_swig = "3.0.8"

VIRTUAL-RUNTIME_syslog = "busybox-syslog"

HOSTTOOLS:append = " xxd"

PACKAGECONFIG:remove:pn-rng-tools = "libjitterentropy"
```

## conf/layer.conf
```bitbake
# We have a conf and classes directory, append to BBPATH
BBPATH .= ":${LAYERDIR}"

# We have a recipes directory, add to BBFILES
BBFILES += "${LAYERDIR}/recipes*/*/*.bb ${LAYERDIR}/recipes*/*/*.bbappend"

BBFILE_COLLECTIONS += "atmel"
BBFILE_PATTERN_atmel := "^${LAYERDIR}/"
BBFILE_PRIORITY_atmel = "10"
LAYERDEPENDS_atmel = "openembedded-layer"

LICENSE_PATH += "${LAYERDIR}/licenses"

SIGGEN_EXCLUDE_SAFE_RECIPE_DEPS += " \
  mchp-egt-demo-init->udev-rules-at91 \
  noto-fonts->fontconfig \
"

BBFILES_DYNAMIC += " \
  meta-aws:${LAYERDIR}/dynamic-layers/aws-layer/*/*/*.bb \
  meta-aws:${LAYERDIR}/dynamic-layers/aws-layer/*/*/*.bbappend \
"

LAYERSERIES_COMPAT_atmel = "kirkstone langdale"
VIRTUAL-RUNTIME_alsa-state = ""
```

## conf/machine/at91ariag25.conf
```bitbake
#@TYPE: Machine
#@Name: AcmeSystems Aria G25
#@DESCRIPTION: Machine configuration for AcmeSystems Aria G25

ASSUME_PROVIDED += "qemu-native"

require conf/machine/include/tune-arm926ejs.inc
DEFAULTTUNE = "arm926ejs"

MACHINE_FEATURES = "apm ext4 ext3 usbhost usbgadget ethernet"
MACHINE_EXTRA_RRECOMMENDS = " kernel-modules"
KERNEL_DEVICETREE = "${S}/arch/arm/boot/dts/at91-ariag25.dts"
SERIAL_CONSOLE ?= "115200 ttyS0"

EXTRA_IMAGEDEPENDS += "at91bootstrap u-boot"

KERNEL_IMAGETYPE = "uImage"

PREFERRED_PROVIDERS += " \
	glibc:eglibc \
	eglibc:eglibc \
	libevent:libevent \
	virtual/kernel:linux-yocto-custom \
"
PREFERRED_PROVIDER_virtual/kernel = "linux-yocto-custom"
```

## conf/machine/at91sam9g25ek.conf
```bitbake
#@TYPE: Machine
#@Name: ATMEL AT91SAM9G25EK
#@DESCRIPTION: Machine configuration for Atmel's evaluation board

require conf/machine/include/at91sam9x5ek.inc

KERNEL_DEVICETREE = " \
		${S}/arch/arm/boot/dts/at91sam9x25ek.dts \
		${S}/arch/arm/boot/dts/at91sam9g25ek.dts \
                     "
```

## conf/machine/at91sam9m10g45ek.conf
```bitbake
#@TYPE: Machine
#@Name: ATMEL AT91SAM9M10G45EK
#@DESCRIPTION: Machine configuration for Atmel's evaluation board

require include/at91sam9.inc

MACHINE_FEATURES = "apm alsa ext2 ext3 usbhost usbgadget screen touchscreen"
KERNEL_DEVICETREE = "at91sam9m10g45ek.dtb \
                     "

IMAGE_FSTYPES += " ubi tar.gz"

# NAND
MKUBIFS_ARGS = " -e 129024 -c 2047 -m 2048  -x lzo"
UBINIZE_ARGS = " -m 2048 -p 128KiB -s 512"

UBI_VOLNAME = "rootfs"

UBOOT_MACHINE = "${MACHINE}_nandflash_config"
UBOOT_ENTRYPOINT = "0x70008000"
UBOOT_LOADADDRESS = "0x70008000"
```

## conf/machine/at91sam9rlek.conf
```bitbake
#@TYPE: Machine
#@Name: ATMEL AT91SAM9RLEK
#@DESCRIPTION: Machine configuration for Atmel's evaluation board

require include/at91sam9.inc

MACHINE_FEATURES = "kernel26 apm alsa ext2 ext3 usbgadget screen touchscreen ppp"

IMAGE_FSTYPES += " ubi tar.gz"

# NAND
MKUBIFS_ARGS = " -e 129024 -c 2047 -m 2048  -x lzo"
UBINIZE_ARGS = " -m 2048 -p 128KiB -s 512"

UBI_VOLNAME = "rootfs"

UBOOT_MACHINE = "${MACHINE}_nandflash_config"
UBOOT_ENTRYPOINT = "0x20008000"
UBOOT_LOADADDRESS = "0x20008000"
```

## conf/machine/at91sam9x5ek-sd.conf
```bitbake
#@TYPE: Machine
#@Name: ATMEL AT91SAM9x5EK SD
#@DESCRIPTION: Machine configuration for Atmel's evaluation board

require include/at91sam9.inc

MACHINE_FEATURES = "apm alsa ext2 ext3 usbhost usbgadget screen touchscreen"
KERNEL_DEVICETREE = "at91sam9g15ek.dtb \
                     at91sam9g25ek.dtb \
                     at91sam9g35ek.dtb \
                     at91sam9x25ek.dtb \
                     at91sam9x35ek.dtb \
                     "

IMAGE_FSTYPES += " tar.gz wic"

do_image_wic[depends] += "u-boot-at91:do_deploy"
WKS_FILE = "sdimage-bootpart.wks"
IMAGE_BOOT_FILES = "BOOT.BIN u-boot.bin at91sam9x5ek.itb"

UBOOT_MACHINE ?= "at91sam9x5ek_mmc_defconfig"
UBOOT_ENTRYPOINT = "0x20008000"
UBOOT_LOADADDRESS = "0x20008000"

AT91BOOTSTRAP_MACHINE ?= "at91sam9x5ek"

# Needed for FIT
MACHINE_ESSENTIAL_EXTRA_RDEPENDS = " dt-overlay-at91"
```

## conf/machine/at91sam9x5ek.conf
```bitbake
#@TYPE: Machine
#@Name: ATMEL AT91SAM9x5EK
#@DESCRIPTION: Machine configuration for Atmel's evaluation board

require include/at91sam9.inc

MACHINE_FEATURES = "kernel26 apm alsa ext2 ext3 usbhost usbgadget screen camera can touchscreen ppp"
KERNEL_DEVICETREE = "at91sam9g15ek.dtb \
                     at91sam9g25ek.dtb \
                     at91sam9g35ek.dtb \
                     at91sam9x25ek.dtb \
                     at91sam9x35ek.dtb \
                     "

IMAGE_FSTYPES += " ubi tar.gz"

# NAND
MKUBIFS_ARGS = " -e 0x1f000 -c 2048 -m 0x800  -x lzo"
UBINIZE_ARGS = " -m 0x800 -p 0x20000 -s 2048"

UBI_VOLNAME = "rootfs"

UBOOT_MACHINE ?= "${MACHINE}_nandflash_config"
UBOOT_ENTRYPOINT = "0x20008000"
UBOOT_LOADADDRESS = "0x20008000"
```

## conf/machine/include/at91sam9.inc
```bitbake
# Atmel AT91SAM9 defaults
require conf/machine/include/soc-family.inc
require conf/machine/include/arm/armv5/tune-arm926ejs.inc
require conf/machine/include/bootloaders.inc

SOC_FAMILY = "at91sam9"

PREFERRED_PROVIDER_virtual/kernel:at91sam9 ?= "linux-mchp"
PREFERRED_PROVIDER_virtual/bootloader:at91sam9 ?= "u-boot-at91"
PREFERRED_PROVIDER_u-boot:at91sam9 ?= "u-boot-at91"

SERIAL_CONSOLES ?= "115200;ttyS0"
```

## conf/machine/include/at91sam9rl.inc
```bitbake
# Atmel AT91SAM9RL defaults
require at91sam9.inc

SOC_FAMILY = "at91sam9:sam9rl"
```

## conf/machine/include/at91sam9x.inc
```bitbake
SOC_FAMILY = "at91sam9x"
require conf/machine/include/soc-family.inc

require conf/machine/include/tune-arm926ejs.inc

# List common SoC features
MACHINE_FEATURES = "kernel26 apm ext2 ext3 usbgadget ppp"

# Default providers
PREFERRED_PROVIDER_virtual/kernel = "linux-yocto-custom"
PREFERRED_PROVIDER_virtual/bootloader = "u-boot-at91"

# Bootloader settings
require conf/machine/include/bootloaders.inc

UBOOT_ENTRYPOINT = "0x20008000"
UBOOT_LOADADDRESS = "0x20008000"
```

## conf/machine/include/at91sam9x5.inc
```bitbake
# Atmel AT91SAM9X5 defaults
require at91sam9.inc

SOC_FAMILY = "at91sam9:sam9x5"
```

## conf/machine/include/at91sam9x5ek.inc
```bitbake
# Common configuration for Atmel SAM9x5 Evaluation Kits

require conf/machine/include/at91sam9x.inc

MACHINE_FEATURES += "usbhost camera can"

# used by sysvinit_2
SERIAL_CONSOLE ?= "115200 ttyS0"

ROOT_FLASH_SIZE = "256"
IMAGE_FSTYPES += " ubi tar.gz"

# NAND
MKUBIFS_ARGS = " -e 0x1f000 -c 2048 -m 0x800  -x lzo"
UBINIZE_ARGS = " -m 0x800 -p 0x20000 -s 2048"

UBI_VOLNAME = "rootfs"
```

## conf/machine/include/bootloaders.inc
```bitbake
# Add bootloaders to the images of every machine
EXTRA_IMAGEDEPENDS += "at91bootstrap at91bootstrap-sam-ba virtual/bootloader"
```

## conf/machine/include/sama5.inc
```bitbake
# Atmel SAMA5 defaults
require conf/machine/include/soc-family.inc
require conf/machine/include/arm/armv7a/tune-cortexa5.inc
require conf/machine/include/bootloaders.inc

SOC_FAMILY = "sama5"

PREFERRED_PROVIDER_virtual/kernel:sama5 ?= "linux-mchp"
PREFERRED_PROVIDER_virtual/bootloader:sama5 ?= "u-boot-mchp"
PREFERRED_PROVIDER_u-boot:sama5 ?= "u-boot-mchp"

PREFERRED_PROVIDER_jpeg ?= "jpeg"
PREFERRED_PROVIDER_jpeg-native ?= "jpeg-native"

SERIAL_CONSOLES ?= "115200;ttyS0"
WIC_CREATE_EXTRA_ARGS ?= "--no-fstab-update"
```

## conf/machine/include/sama5d2-bsr.inc
```bitbake
# Atmel SAMA5D2 defaults
require sama5.inc

SOC_FAMILY = "sama5:sama5d2-bsr"

DEFAULTTUNE = "cortexa5thf-neon"
```

## conf/machine/include/sama5d2.inc
```bitbake
# Atmel SAMA5D2 defaults
require sama5.inc

SOC_FAMILY = "sama5:sama5d2"

DEFAULTTUNE = "cortexa5thf-neon"
```

## conf/machine/include/sama5d3.inc
```bitbake
# Atmel SAMA5D3 defaults
require sama5.inc

SOC_FAMILY = "sama5:sama5d3"

DEFAULTTUNE = "cortexa5thf"
```

## conf/machine/include/sama5d3x.inc
```bitbake
SOC_FAMILY = "sama5d3x"
require conf/machine/include/soc-family.inc

DEFAULTTUNE ?= "cortexa5thf"
require conf/machine/include/tune-cortexa5.inc

# Default tune does not use the correct FPU, change CCARGS to fix it.
TUNE_CCARGS += "-mfpu=vfpv4-d16"

# List common SoC features
MACHINE_FEATURES = "kernel26 apm ext2 ext3 usbhost usbgadget ppp"

# Bootloader settings
require conf/machine/include/bootloaders.inc

UBOOT_ENTRYPOINT = "0x20008000"
UBOOT_LOADADDRESS = "0x20008000"
```

## conf/machine/include/sama5d3xek.inc
```bitbake
# Common configuration for Atmel SAMA5D3x Evaluation Kits

require conf/machine/include/sama5d3x.inc

# used by sysvinit_2
SERIAL_CONSOLE ?= "115200 ttyS0"

ROOT_FLASH_SIZE = "256"
IMAGE_FSTYPES += " ubi tar.gz"

# NAND
MKUBIFS_ARGS = " -e 0x1f000 -c 2048 -m 0x800  -x lzo"
UBINIZE_ARGS = " -m 0x800 -p 0x20000 -s 2048"

UBI_VOLNAME = "rootfs"

UBOOT_MACHINE = "sama5d3xek_nandflash_config"
UBOOT_FIT_IMAGE = "xyes"
```

## conf/machine/include/sama7.inc
```bitbake
# Microchip SAMA7 defaults
require conf/machine/include/soc-family.inc
require conf/machine/include/arm/armv7a/tune-cortexa7.inc
require conf/machine/include/bootloaders.inc

SOC_FAMILY = "sama7"

PREFERRED_PROVIDER_virtual/kernel:sama7 ?= "linux-at91"
PREFERRED_PROVIDER_virtual/bootloader:sama7 ?= "u-boot-at91"
PREFERRED_PROVIDER_u-boot:sama7 ?= "u-boot-at91"

PREFERRED_PROVIDER_jpeg ?= "jpeg"
PREFERRED_PROVIDER_jpeg-native ?= "jpeg-native"

SERIAL_CONSOLES ?= "115200;ttyS0"
WIC_CREATE_EXTRA_ARGS ?= "--no-fstab-update"

# default kernel defconfig
KBUILD_DEFCONFIG = "sama7_defconfig"
```

## conf/machine/sam9x60-curiosity-sd.conf
```bitbake
#@TYPE: Machine
#@Name: MICROCHIP SAM9X60-CURIOSITY SD
#@DESCRIPTION: Machine configuration for Microchip SAM9X60 curiosity board

require include/sam9x60.inc

MACHINE_FEATURES = "apm alsa ext2 ext3 usbhost usbgadget screen touchscreen"
KERNEL_DEVICETREE = " at91-sam9x60_curiosity.dtb "

IMAGE_FSTYPES += " tar.gz wic"

do_image_wic[depends] += "u-boot-at91:do_deploy"
WKS_FILE = "sdimage-bootpart.wks"
IMAGE_BOOT_FILES = "BOOT.BIN u-boot.bin uboot.env sam9x60_curiosity.itb"

UBOOT_MACHINE ?= "sam9x60_curiosity_mmc_defconfig"
UBOOT_ENTRYPOINT = "0x20008000"
UBOOT_LOADADDRESS = "0x20008000"
UBOOT_ENV_SIZE = "0x4000"

AT91BOOTSTRAP_MACHINE ?= "sam9x60_curiosity"

# Needed for wic
EXTRA_IMAGEDEPENDS += "dosfstools-native mtools-native"

# Needed for FIT
MACHINE_ESSENTIAL_EXTRA_RDEPENDS = " dt-overlay-mchp"
```

## conf/machine/sam9x60ek-sd.conf
```bitbake
#@TYPE: Machine
#@Name: MICROCHIP SAM9X60-EK SD
#@DESCRIPTION: Machine configuration for Microchip SAM9X60's evaluation board

require include/sam9x60.inc

MACHINE_FEATURES = "apm alsa ext2 ext3 usbhost usbgadget screen touchscreen"
KERNEL_DEVICETREE = " at91-sam9x60ek.dtb "

IMAGE_FSTYPES += " tar.gz wic"

do_image_wic[depends] += "u-boot-at91:do_deploy"
WKS_FILE = "sdimage-bootpart.wks"
IMAGE_BOOT_FILES = "BOOT.BIN u-boot.bin uboot.env sam9x60ek.itb"

UBOOT_MACHINE ?= "sam9x60ek_mmc_defconfig"
UBOOT_ENTRYPOINT = "0x20008000"
UBOOT_LOADADDRESS = "0x20008000"
UBOOT_ENV_SIZE = "0x4000"

AT91BOOTSTRAP_MACHINE ?= "sam9x60ek"

# Needed for wic
EXTRA_IMAGEDEPENDS += "dosfstools-native mtools-native"

# Needed for FIT
MACHINE_ESSENTIAL_EXTRA_RDEPENDS = " dt-overlay-at91"
```
