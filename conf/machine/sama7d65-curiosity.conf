## conf/machine/sama7d65-curiosity.conf
```bitbake
#@TYPE: Machine
#@Name: MICROCHIP SAM7D65-CURIOSITY NAND
#@DESCRIPTION: Machine configuration for Microchip SAM9X75-CURIOSITY board

require include/sama7d65.inc

MACHINE_FEATURES = "apm alsa ext2 ext3 usbhost usbgadget screen touchscreen"
KERNEL_DEVICETREE = " at91-sama7d65_curiosity.dtb "

IMAGE_FSTYPES += " ubi tar.gz"

# NAND
MKUBIFS_ARGS = " -e 0x3e000 -c 2082 -m 0x1000 -x lzo"
UBINIZE_ARGS = " -m 0x1000 -p 0x40000"
MKENVIMAGE_EXTRA_ARGS = " -r "

UBI_VOLNAME = "rootfs"

UBOOT_MACHINE ?= "sama7d65_curiosity_nandflash_defconfig"
UBOOT_ENTRYPOINT = "0x62000000"
UBOOT_LOADADDRESS = "0x62000000"
UBOOT_ENV_SIZE = "0x4000"

AT91BOOTSTRAP_MACHINE ?= "sama7d65_curiosity"

# Needed for FIT
MACHINE_ESSENTIAL_EXTRA_RDEPENDS = " dt-overlay-mchp"
```

## meta-mchp-common/conf/layer.conf
```bitbake
# We have a conf and classes directory, add to BBPATH
BBPATH .= ":${LAYERDIR}"

# We have recipes-* directories, add to BBFILES
BBFILES += "${LAYERDIR}/recipes-*/*/*.bb \
            ${LAYERDIR}/recipes-*/*/*.bbappend"

BBFILE_COLLECTIONS += "meta-mchp-common"
BBFILE_PATTERN_meta-mchp-common = "^${LAYERDIR}/"
BBFILE_PRIORITY_meta-mchp-common = "6"

LAYERDEPENDS_meta-mchp-common = "core"
LAYERSERIES_COMPAT_meta-mchp-common = "scarthgap styhead"

LICENSE_PATH += "${LAYERDIR}/licenses"

BBFILES_DYNAMIC += " \
    meta-python:${LAYERDIR}/dynamic-layers/meta-python/recipes-*/*/*.bb \
    meta-python:${LAYERDIR}/dynamic-layers/meta-python/recipes-*/*/*.bbappend \
    networking-layer:${LAYERDIR}/dynamic-layers/networking-layer/recipes-*/*/*.bb \
    networking-layer:${LAYERDIR}/dynamic-layers/networking-layer/recipes-*/*/*.bbappend \
    openembedded-layer:${LAYERDIR}/dynamic-layers/openembedded-layer/recipes-*/*/*.bb \
    openembedded-layer:${LAYERDIR}/dynamic-layers/openembedded-layer/recipes-*/*/*.bbappend \
"
```

## meta-mchp-distro/conf/distro/mchp-distro.conf
```bitbake
DISTRO = "mchp-distro"
DISTRO_NAME = "Microchip Distro"
DISTRO_VERSION = "1.0"

DISTROOVERRIDES = "${DISTRO}"
TARGET_VENDOR = "-mchp"
SDK_VENDOR = "-mchpsdk"

MAINTAINER = "\
		Valentina Fernandez <valentina.fernandezalanis@microchip.com> \
		Nicolas Ferre <nicolas.ferre@microchip.com> \
		Dharma Balasubiramani <dharma.b@microchip.com> \
		"

MCHP_INIT_MANAGER ?= "systemd"
PACKAGE_CLASSES ?= "package_ipk"

MCHP_DEFAULT_DISTRO_FEATURES = ""
DISTRO_FEATURES ?= "${DISTRO_FEATURES_DEFAULT} ${MCHP_DEFAULT_DISTRO_FEATURES}"

PACKAGE_CLASSES ?= "package_ipk"

INIT_MANAGER ?= "${MCHP_INIT_MANAGER}"
```

## meta-mchp-distro/conf/layer.conf
```bitbake
# We have a conf directory, add to BBPATH
BBPATH .= ":${LAYERDIR}"

# We have recipes-* directories, add to BBFILES
BBFILES += "${LAYERDIR}/recipes-*/*/*.bb \
            ${LAYERDIR}/recipes-*/*/*.bbappend"

BBFILE_COLLECTIONS += "mchp-common-distro"
BBFILE_PATTERN_mchp-common-distro = "^${LAYERDIR}/"
BBFILE_PRIORITY_mchp-common-distro = "5"

LICENSE_PATH += "${LAYERDIR}/licenses"

LAYERSERIES_COMPAT_mchp-common-distro = "scarthgap"

LAYERDEPENDS_mchp-common-distro = "core"

BBFILES_DYNAMIC += " \
    openembedded-layer:${LAYERDIR}/dynamic-layers/openembedded-layer/recipes-*/*/*.bb \
    openembedded-layer:${LAYERDIR}/dynamic-layers/openembedded-layer/recipes-*/*/*.bbappend \
    "
```

## meta-mchp-mpu/conf/machine/sam9x60-curiosity.conf
```bitbake
#@TYPE: Machine
#@Name: MICROCHIP SAM9X60-CURIOSITY NAND
#@DESCRIPTION: Machine configuration for Microchip SAM9X60 curiosity nand board

require include/sam9x60.inc

KERNEL_DEVICETREE = "microchip/at91-sam9x60_curiosity.dtb"
DT_MACHINE ?= "sam9x60_curiosity"

IMAGE_FSTYPES += " ubi tar.gz"

# NAND
MKUBIFS_ARGS = " -e 0x3e000 -c 2082 -m 0x1000 -x lzo"
UBINIZE_ARGS = " -m 0x1000 -p 0x40000"
MKENVIMAGE_EXTRA_ARGS = " -r "

UBI_VOLNAME = "rootfs"

UBOOT_MACHINE ?= "sam9x60_curiosity_nandflash_defconfig"
UBOOT_ENTRYPOINT = "0x20008000"
UBOOT_LOADADDRESS = "0x20008000"
UBOOT_ENV_SIZE = "0x20000"

MACHINEOVERRIDES =. "sam9x60_curiosity:"
```

## meta-mchp-mpu/conf/machine/sam9x60ek.conf
```bitbake
#@TYPE: Machine
#@Name: MICROCHIP SAM9X60-EK NAND
#@DESCRIPTION: Machine configuration for Microchip SAM9X60 nand evaluation kit

require include/sam9x60.inc

KERNEL_DEVICETREE = "microchip/at91-sam9x60ek.dtb"
DT_MACHINE ?= "sam9x60ek"

IMAGE_FSTYPES += " ubi tar.gz"

# NAND
MKUBIFS_ARGS = " -e 0x3e000 -c 2082 -m 0x1000 -x lzo"
UBINIZE_ARGS = " -m 0x1000 -p 0x40000"
MKENVIMAGE_EXTRA_ARGS = " -r "

UBI_VOLNAME = "rootfs"

UBOOT_MACHINE ?= "sam9x60ek_nandflash_defconfig"
UBOOT_ENTRYPOINT = "0x20008000"
UBOOT_LOADADDRESS = "0x20008000"
UBOOT_ENV_SIZE = "0x20000"

MACHINEOVERRIDES =. "sam9x60ek:"
```

## meta-mchp-mpu/conf/machine/sam9x75-curiosity-sd.conf
```bitbake
#@TYPE: Machine
#@Name: MICROCHIP SAM9X75-CURIOSITY SD
#@DESCRIPTION: Machine configuration for Microchip SAM9X75 curiosity sd board

require include/sam9x75.inc

KERNEL_DEVICETREE = "microchip/at91-sam9x75_curiosity.dtb"
DT_MACHINE ?= "sam9x75_curiosity"

IMAGE_FSTYPES += " tar.gz wic"

WKS_FILE = "sdimage-bootpart.wks"

IMAGE_BOOT_FILES = "BOOT.BIN u-boot.bin uboot.env sam9x75_curiosity.itb"

UBOOT_MACHINE ?= "sam9x75_curiosity_mmc_defconfig"
UBOOT_ENTRYPOINT = "0x20008000"
UBOOT_LOADADDRESS = "0x20008000"
UBOOT_ENV_SIZE = "0x4000"

# Needed for wic
EXTRA_IMAGEDEPENDS += "dosfstools-native mtools-native"

MACHINEOVERRIDES =. "sam9x75_curiosity:"
```

## meta-mchp-mpu/conf/machine/sama5d2-icp-sd.conf
```bitbake
#@TYPE: Machine
#@Name: MICROCHIP SAMA5D2-ICP SD
#@DESCRIPTION: Machine configuration for Microchip SAMA5D2-ICP sd board

require include/sama5d2.inc

MACHINE_FEATURES = "apm ext2 ext3 usbhost usbgadget"
KERNEL_DEVICETREE = "microchip/at91-sama5d2_icp.dtb"
DT_MACHINE ?= "sama5d2_icp"

IMAGE_FSTYPES += " tar.gz wic"

WKS_FILE = "sdimage-bootpart.wks"

IMAGE_BOOT_FILES = "BOOT.BIN u-boot.bin uboot.env sama5d2_icp.itb"

UBOOT_MACHINE ?= "sama5d2_icp_mmc_defconfig"
UBOOT_ENTRYPOINT = "0x20008000"
UBOOT_LOADADDRESS = "0x20008000"
UBOOT_ENV_SIZE = "0x4000"

MACHINEOVERRIDES =. "sama5d2_icp:"
```

## meta-mchp-mpu/conf/machine/sama5d2-ptc-ek.conf
```bitbake
#@TYPE: Machine
#@Name: MICROCHIP SAMA5D2-PTC-EK nand
#@DESCRIPTION: Machine configuration for Microchip SAMA5D2-PTC nand Evaluation Kit

require include/sama5d2.inc

MACHINE_FEATURES = "apm ext2 ext3 usbhost usbgadget touchscreen"
KERNEL_DEVICETREE = "microchip/at91-sama5d2_ptc_ek.dtb"
DT_MACHINE ?= "sama5d2_ptc_ek"

IMAGE_FSTYPES += " ubi tar.gz"

MACHINE_ESSENTIAL_EXTRA_RDEPENDS += " dt-overlay-mchp"

# Add deploy functions to the wic image dependency
do_image_wic[depends] += " u-boot-mchp:do_deploy"
do_image_wic[depends] += " dt-overlay-mchp:do_deploy"

# NAND
MKUBIFS_ARGS = " -e 0x1f000 -c 4000 -m 0x800 -x lzo"
UBINIZE_ARGS = " -m 0x800 -p 0x20000"
MKENVIMAGE_EXTRA_ARGS = " -r "

UBI_VOLNAME = "rootfs"

UBOOT_MACHINE ?= "sama5d2_ptc_ek_nandflash_defconfig"
UBOOT_ENTRYPOINT = "0x20008000"
UBOOT_LOADADDRESS = "0x20008000"
UBOOT_ENV_SIZE = "0x20000"

MACHINEOVERRIDES =. "mpuall:sama5d2_ptc_ek:"
```

## meta-mchp-mpu/conf/machine/sama5d27-som1-ek-optee-sd.conf
```bitbake
#@TYPE: Machine
#@Name: MICROCHIP SAMA5D2-SOM1-EK-OPTEE SD
#@DESCRIPTION: Machine configuration for Microchip SAMA5D2-SOM1 optee sd evaluation kit

require include/sama5d2.inc

MACHINE_FEATURES = "apm alsa ext2 ext3 usbhost usbgadget touchscreen"
KERNEL_DEVICETREE = "microchip/at91-sama5d27_som1_ek.dtb"
DT_MACHINE ?= "sama5d27_som1_ek"

IMAGE_FSTYPES += " tar.gz wic"
WKS_FILE = "sdimage-bootpart.wks"

IMAGE_INSTALL += " optee-os optee-test optee-examples "
IMAGE_BOOT_FILES = "BOOT.BIN u-boot.bin uboot.env sama5d27_som1_ek.itb tee.bin"

UBOOT_MACHINE ?= "sama5d27_som1_ek_mmc_optee_defconfig"
UBOOT_ENV_SIZE = "0x1000"

MACHINEOVERRIDES =. "sama5d27_som1_ek:"
```

## meta-mchp-mpu/conf/machine/sama5d29-curiosity-sd.conf
```bitbake
#@TYPE: Machine
#@Name: Microchip SAMA5D29-CURIOSITY SD
#@DESCRIPTION: Machine configuration for Microchip SAMA5D29 curiosity sd board

require include/sama5d2.inc

MACHINE_FEATURES = "apm alsa ext2 ext3 usbhost usbgadget touchscreen"
KERNEL_DEVICETREE = "microchip/at91-sama5d29_curiosity.dtb"
DT_MACHINE ?= "sama5d29_curiosity"

IMAGE_FSTYPES += " tar.gz wic"
WKS_FILE = "sdimage-bootpart.wks"

IMAGE_BOOT_FILES = "BOOT.BIN u-boot.bin uboot.env sama5d29_curiosity.itb"

UBOOT_MACHINE ?= "sama5d29_curiosity_mmc_defconfig"
UBOOT_ENTRYPOINT = "0x20008000"
UBOOT_LOADADDRESS = "0x20008000"
UBOOT_ENV_SIZE = "0x4000"

# Needed for wic
EXTRA_IMAGEDEPENDS += "dosfstools-native mtools-native"

MACHINE_ESSENTIAL_EXTRA_RDEPENDS += " dt-overlay-mchp"

# Add deploy functions to the wic image dependency
do_image_wic[depends] += " u-boot-mchp:do_deploy"
do_image_wic[depends] += " dt-overlay-mchp:do_deploy"

MACHINEOVERRIDES =. "mpuall:sama5d29_curiosity:"
```

## meta-mchp-mpu/conf/machine/sama5d3-xplained.conf
```bitbake
#@TYPE: Machine
#@Name: MICROCHIP SAMA5D3 Xplained
#@DESCRIPTION: Machine configuration for Microchip SAMA5D3 Xplained nand board

require include/sama5d3.inc

MACHINE_FEATURES += " wifi"
KERNEL_DEVICETREE = "microchip/at91-sama5d3_xplained.dtb"
DT_MACHINE ?= "sama5d3_xplained"

# used by sysvinit_2
SERIAL_CONSOLES ?= "115200;ttyS0 115200;ttyGS0"

IMAGE_FSTYPES += " ubi tar.gz"

MACHINE_ESSENTIAL_EXTRA_RDEPENDS += " dt-overlay-mchp"

# Add deploy functions to the wic image dependency
do_image_wic[depends] += " u-boot-mchp:do_deploy"
do_image_wic[depends] += " dt-overlay-mchp:do_deploy"

# NAND
MKUBIFS_ARGS ?= " -e 0x1f000 -c 2048 -m 0x800  -x lzo"
UBINIZE_ARGS ?= " -m 0x800 -p 0x20000 -s 2048"
MKENVIMAGE_EXTRA_ARGS = " -r "

UBI_VOLNAME = "rootfs"

UBOOT_MACHINE ?= "sama5d3_xplained_nandflash_config"
UBOOT_ENTRYPOINT = "0x20008000"
UBOOT_LOADADDRESS = "0x20008000"
UBOOT_ENV_SIZE = "0x20000"

MACHINEOVERRIDES =. "mpuall:sama5d3_xplained:"
```

## meta-mchp-mpu/conf/machine/sama5d4-xplained.conf
```bitbake
#@TYPE: Machine
#@Name: MICROCHIP SAMA5D4 Xplained Ultra NAND
#@DESCRIPTION: Machine configuration for Microchip SAMA5D4 xplained nand board

require include/sama5d4.inc

KERNEL_DEVICETREE = "microchip/at91-sama5d4_xplained.dtb"
DT_MACHINE ?= "sama5d4_xplained"

IMAGE_FSTYPES += " ubi tar.gz"

MACHINE_ESSENTIAL_EXTRA_RDEPENDS += " dt-overlay-mchp"

# Add deploy functions to the wic image dependency
do_image_wic[depends] += " u-boot-mchp:do_deploy"
do_image_wic[depends] += " dt-overlay-mchp:do_deploy"

# NAND
MKUBIFS_ARGS = " -e 0x3e000 -c 2082 -m 0x1000 -x lzo"
UBINIZE_ARGS = " -m 0x1000 -p 0x40000"
MKENVIMAGE_EXTRA_ARGS = " -r "

UBI_VOLNAME = "rootfs"

UBOOT_MACHINE ?= "sama5d4_xplained_nandflash_config"
UBOOT_ENTRYPOINT = "0x20008000"
UBOOT_LOADADDRESS = "0x20008000"
UBOOT_ENV_SIZE = "0x20000"

MACHINEOVERRIDES =. "mpuall:sama5d4_xplained:"
```

## meta-mchp-mpu/conf/machine/sama7d65-curiosity-sd.conf
```bitbake
#@TYPE: Machine
#@Name: Microchip SAMA7D65-CURIOSITY SD
#@DESCRIPTION: Machine configuration for Microchip SAMA7D65 curiosity sd board

require include/sama7d65.inc

MACHINE_FEATURES = "apm alsa ext2 ext3 usbhost usbgadget"
KERNEL_DEVICETREE = "microchip/at91-sama7d65_curiosity.dtb"
DT_MACHINE ?= "sama7d65_curiosity"

IMAGE_FSTYPES += " tar.gz wic"

WKS_FILE = "sdimage-bootpart.wks"
IMAGE_BOOT_FILES = "BOOT.BIN u-boot.bin uboot.env sama7d65_curiosity.itb"

UBOOT_MACHINE ?= "sama7d65_curiosity_mmc1_defconfig"
UBOOT_ENTRYPOINT = "0x62000000"
UBOOT_LOADADDRESS = "0x62000000"
UBOOT_ENV_SIZE = "0x4000"

MACHINE_ESSENTIAL_EXTRA_RDEPENDS += " dt-overlay-mchp"

# Add deploy functions to the wic image dependency
do_image_wic[depends] += " u-boot-mchp:do_deploy"
do_image_wic[depends] += " dt-overlay-mchp:do_deploy"

MACHINEOVERRIDES =. "mpuall:sama7d65:"
```

## meta-mchp-mpu/conf/machine/sama7d65-curiosity.conf
```bitbake
#@TYPE: Machine
#@Name: MICROCHIP SAM7D65-CURIOSITY NAND
#@DESCRIPTION: Machine configuration for Microchip SAM9X75 curiosity nand board

require include/sama7d65.inc

KERNEL_DEVICETREE = "microchip/at91-sama7d65_curiosity.dtb"
DT_MACHINE ?= "sama7d65_curiosity"

IMAGE_FSTYPES += " ubi tar.gz"

# NAND
MKUBIFS_ARGS = " -e 0x3e000 -c 2082 -m 0x1000 -x lzo"
UBINIZE_ARGS = " -m 0x1000 -p 0x40000"
MKENVIMAGE_EXTRA_ARGS = " -r "

UBI_VOLNAME = "rootfs"

UBOOT_MACHINE ?= "sama7d65_curiosity_nandflash_defconfig"
UBOOT_ENTRYPOINT = "0x62000000"
UBOOT_LOADADDRESS = "0x62000000"
UBOOT_ENV_SIZE = "0x4000"

MACHINEOVERRIDES =. "sama7d65:"
```

## meta-mchp-mpu/conf/machine/sama7g5ek-optee-sd.conf
```bitbake
#@TYPE: Machine
#@Name: Microchip SAMA7G5-EK OPTEE SD
#@DESCRIPTION: Machine configuration for Microchip SAMA7G5 optee sd evaluation kit

require include/sama7g5.inc

MACHINE_FEATURES = "apm alsa ext2 ext3 usbhost usbgadget"
KERNEL_DEVICETREE = "microchip/at91-sama7g5ek.dtb"
DT_MACHINE ?= "sama7g5ek"

IMAGE_FSTYPES += " tar.gz wic"

WKS_FILE = "sdimage-bootpart.wks"

IMAGE_INSTALL += " optee-os optee-test optee-examples "
IMAGE_BOOT_FILES = "BOOT.BIN u-boot.bin uboot.env sama7g5ek.itb tee.bin"

UBOOT_MACHINE ?= "sama7g5ek_mmc1_optee_defconfig"
UBOOT_ENV_SIZE = "0x4000"

MACHINEOVERRIDES =. "sama7g5ek:"
```

## meta-mchp-mpu/conf/machine/sama7g5ek-ospi.conf
```bitbake
#@TYPE: Machine
#@Name: Microchip SAMA7G5-EK oSPI
#@DESCRIPTION: Machine configuration for Microchip SAMA7G5 ospi evaluation kit

require include/sama7g5.inc

MACHINE_FEATURES = "apm ubi usbhost usbgadget"
KERNEL_DEVICETREE = "microchip/at91-sama7g5ek.dtb"
DT_MACHINE ?= "sama7g5ek"

IMAGE_FSTYPES += "ubi tar.gz"

IMAGE_ROOTFS_SIZE = "122880"
IMAGE_ROOTFS_MAXSIZE = "122880"
MKUBIFS_ARGS = " -e 0xff80 -c 1924 -m 1"
UBINIZE_ARGS = " -m 1 -p 0x10000 -O 64 -s 1"

UBI_VOLNAME = "rootfs"

UBOOT_MACHINE ?= "sama7g5ek_qspi0_defconfig"
UBOOT_ENTRYPOINT = "0x62000000"
UBOOT_LOADADDRESS = "0x62000000"
UBOOT_ENV_SIZE = "0x4000"

MACHINEOVERRIDES =. "mpuall:sama7g5ek:"

# OSPI image must fit into 120 MBytes
IMAGE_INSTALL:forcevariable = "\
    can-utils \
    dosfstools \
    devmem2 \
    evtest \
    fswebcam \
    gstreamer1.0-plugins-base \
    i2c-tools \
    kernel-modules \
    libgpiod-tools \
    libv4l \
    linuxptp \
    lmbench \
    ltrace \
    media-ctl \
    mtd-utils \
    mtd-utils-ubifs \
    packagegroup-base-wifi \
    packagegroup-base-usbgadget \
    packagegroup-core-boot \
    phytool \
    rng-tools \
    setserial \
    strace \
    stress-ng \
    systemd-analyze \
    usbutils \
    video-capture-at91\
    v4l-utils \
    wget \
"
IMAGE_FEATURES:remove = "package-management"

MACHINE_ESSENTIAL_EXTRA_RDEPENDS += " dt-overlay-mchp"

# Add deploy functions to the wic image dependency
do_image_wic[depends] += " u-boot-mchp:do_deploy"
do_image_wic[depends] += " dt-overlay-mchp:do_deploy"
```

## meta-mchp-mpu/meta-mchp-mpu-bsp/conf/layer.conf
```bitbake
# We have a conf and classes directory, add to BBPATH
BBPATH .= ":${LAYERDIR}"

# We have recipes-* directories, add to BBFILES
BBFILES += "${LAYERDIR}/recipes-*/*/*.bb \
            ${LAYERDIR}/recipes-*/*/*.bbappend"

BBFILE_COLLECTIONS += "meta-mchp-mpu-bsp"
BBFILE_PATTERN_meta-mchp-mpu-bsp = "^${LAYERDIR}/"
BBFILE_PRIORITY_meta-mchp-mpu-bsp = "6"

LICENSE_PATH += "${LAYERDIR}/licenses"

LAYERDEPENDS_meta-mchp-mpu-bsp = "meta-mchp-common meta-arm"
LAYERSERIES_COMPAT_meta-mchp-mpu-bsp = "scarthgap styhead"

BBFILES_DYNAMIC += " \
    meta-python:${LAYERDIR}/dynamic-layers/meta-python/recipes-*/*/*.bb \
    meta-python:${LAYERDIR}/dynamic-layers/meta-python/recipes-*/*/*.bbappend \
    openembedded-layer:${LAYERDIR}/dynamic-layers/openembedded-layer/recipes-*/*/*.bb \
    openembedded-layer:${LAYERDIR}/dynamic-layers/openembedded-layer/recipes-*/*/*.bbappend \
"
```
