## conf/machine/sama7g5ek-emmc.conf
```bitbake
#@TYPE: Machine
#@Name: Microchip SAMA7G5-EK eMMC
#@DESCRIPTION: Machine configuration for Microchip's evaluation kit board

require include/sama7g5.inc

MACHINE_FEATURES = "apm alsa ext2 ext3 usbhost usbgadget"
KERNEL_DEVICETREE = " \
		at91-sama7g5ek.dtb \
		"

IMAGE_FSTYPES += " tar.gz wic"

do_image_wic[depends] += "u-boot-at91:do_deploy"
WKS_FILE = "sdimage-bootpart.wks"
IMAGE_BOOT_FILES = "BOOT.BIN u-boot.bin uboot.env sama7g5ek.itb"

UBOOT_MACHINE ?= "sama7g5ek_mmc_defconfig"
UBOOT_ENTRYPOINT = "0x62000000"
UBOOT_LOADADDRESS = "0x62000000"
UBOOT_ENV_SIZE = "0x4000"

AT91BOOTSTRAP_MACHINE ?= "sama7g5ek"

# Needed for FIT
MACHINE_ESSENTIAL_EXTRA_RDEPENDS = " dt-overlay-at91"

MACHINEOVERRIDES =. "sama7g5ek:"
```

## conf/machine/sama7g5ek-ospi.conf
```bitbake
#@TYPE: Machine
#@Name: Microchip SAMA7G5-EK oSPI
#@DESCRIPTION: Machine configuration for Microchip's evaluation kit board

require include/sama7g5.inc

MACHINE_FEATURES = "apm ubi usbhost usbgadget"
KERNEL_DEVICETREE = " \
		at91-sama7g5ek.dtb \
		"

IMAGE_FSTYPES += "ubi tar.gz"

IMAGE_ROOTFS_SIZE = "122880"
IMAGE_ROOTFS_MAXSIZE = "122880"
MKUBIFS_ARGS = " -e 0xff80 -c 1924 -m 1"
UBINIZE_ARGS = " -m 1 -p 0x10000 -O 64 -s 1"

UBI_VOLNAME = "rootfs"

UBOOT_MACHINE ?= "sama7g5ek_qspi0_defconfig"
UBOOT_ENTRYPOINT = "0x62000000"
UBOOT_LOADADDRESS = "0x62000000"
UBOOT_ENV_SIZE = "0x4000"

AT91BOOTSTRAP_MACHINE ?= "sama7g5ek"

# Needed for FIT
MACHINE_ESSENTIAL_EXTRA_RDEPENDS = " dt-overlay-mchp"

MACHINEOVERRIDES =. "sama7g5ek:"
```
