## conf/machine/sam9x60ek.conf
```bitbake
#@TYPE: Machine
#@Name: MICROCHIP SAM9X60-EK NAND
#@DESCRIPTION: Machine configuration for Microchip SAM9X6-EK's evaluation board

require include/sam9x60.inc

MACHINE_FEATURES = "apm alsa ext2 ext3 usbhost usbgadget screen touchscreen"
KERNEL_DEVICETREE = " at91-sam9x60ek.dtb "

IMAGE_FSTYPES += " ubi tar.gz"

# NAND
MKUBIFS_ARGS = " -e 0x3e000 -c 2082 -m 0x1000 -x lzo"
UBINIZE_ARGS = " -m 0x1000 -p 0x40000"

UBI_VOLNAME = "rootfs"

UBOOT_MACHINE ?= "sam9x60ek_nandflash_defconfig"
UBOOT_ENTRYPOINT = "0x20008000"
UBOOT_LOADADDRESS = "0x20008000"

AT91BOOTSTRAP_MACHINE ?= "sam9x60ek"

# Needed for FIT
MACHINE_ESSENTIAL_EXTRA_RDEPENDS = " dt-overlay-at91"
```

## conf/machine/sam9x75eb-sd.conf
```bitbake
#@TYPE: Machine
#@Name: MICROCHIP SAM9X75EB SD
#@DESCRIPTION: Machine configuration for Microchip SAM9X75EB board

require include/sam9x75.inc

MACHINE_FEATURES = "apm alsa ext2 ext3 usbhost usbgadget screen touchscreen"
KERNEL_DEVICETREE = " at91-sam9x75eb.dtb "

IMAGE_FSTYPES += " tar.gz wic"

do_image_wic[depends] += "u-boot-at91:do_deploy"
WKS_FILE = "sdimage-bootpart.wks"
IMAGE_BOOT_FILES = "BOOT.BIN u-boot.bin uboot.env sam9x75eb.itb"

UBOOT_MACHINE ?= "sam9x75eb_mmc_defconfig"
UBOOT_ENTRYPOINT = "0x20008000"
UBOOT_LOADADDRESS = "0x20008000"
UBOOT_ENV_SIZE = "0x4000"

AT91BOOTSTRAP_MACHINE ?= "sam9x75eb"

# Needed for wic
EXTRA_IMAGEDEPENDS += "dosfstools-native mtools-native"

# Needed for FIT
MACHINE_ESSENTIAL_EXTRA_RDEPENDS = " dt-overlay-mchp"
```

## conf/machine/sama5d2-icp-sd.conf
```bitbake
#@TYPE: Machine
#@Name: ATMEL SAMA5D2 ICP SD
#@DESCRIPTION: Machine configuration for Microchip SAMA5D2 ICP Evaluation Kit

require include/sama5d2.inc

MACHINE_FEATURES = "apm ext2 ext3 usbhost usbgadget"
KERNEL_DEVICETREE = " \
		at91-sama5d2_icp.dtb \
		"
IMAGE_FSTYPES += " tar.gz wic"

do_image_wic[depends] += "u-boot-at91:do_deploy"
WKS_FILE = "sdimage-bootpart.wks"
IMAGE_BOOT_FILES = "BOOT.BIN u-boot.bin uboot.env sama5d2_icp.itb"

UBOOT_MACHINE ?= "sama5d2_icp_mmc_defconfig"
UBOOT_ENTRYPOINT = "0x20008000"
UBOOT_LOADADDRESS = "0x20008000"
UBOOT_ENV_SIZE = "0x4000"

AT91BOOTSTRAP_MACHINE ?= "sama5d2_icp"

# Needed for FIT
MACHINE_ESSENTIAL_EXTRA_RDEPENDS = " dt-overlay-at91"
```

## conf/machine/sama5d2-ptc-ek-sd.conf
```bitbake
#@TYPE: Machine
#@Name: ATMEL SAMA5D2 PTC EK SD
#@DESCRIPTION: Machine configuration for Microchip SAMA5D2 PTC Evaluation Kit

require include/sama5d2.inc

MACHINE_FEATURES = "apm ext2 ext3 usbhost usbgadget touchscreen"
KERNEL_DEVICETREE = " \
		at91-sama5d2_ptc_ek.dtb \
		"
IMAGE_FSTYPES += " tar.gz wic"

do_image_wic[depends] += "u-boot-at91:do_deploy"
WKS_FILE = "sdimage-bootpart.wks"
IMAGE_BOOT_FILES = "BOOT.BIN u-boot.bin sama5d2_ptc_ek.itb"

UBOOT_MACHINE ?= "sama5d2_ptc_ek_mmc_defconfig"
UBOOT_ENTRYPOINT = "0x20008000"
UBOOT_LOADADDRESS = "0x20008000"

AT91BOOTSTRAP_MACHINE ?= "sama5d2_ptc_ek"

# Needed for FIT
MACHINE_ESSENTIAL_EXTRA_RDEPENDS = " dt-overlay-at91"
```

## conf/machine/sama5d2-ptc-ek.conf
```bitbake
#@TYPE: Machine
#@Name: ATMEL SAMA5D2 PTC EK
#@DESCRIPTION: Machine configuration for Microchip SAMA5D2 PTC Evaluation Kit

require include/sama5d2.inc

MACHINE_FEATURES = "apm ext2 ext3 usbhost usbgadget touchscreen"
KERNEL_DEVICETREE = " \
		at91-sama5d2_ptc_ek.dtb \
		"
IMAGE_FSTYPES += " ubi tar.gz"

# NAND
MKUBIFS_ARGS = " -e 0x1f000 -c 4000 -m 0x800 -x lzo"
UBINIZE_ARGS = " -m 0x800 -p 0x20000"

UBI_VOLNAME = "rootfs"

UBOOT_MACHINE ?= "sama5d2_ptc_ek_nandflash_defconfig"
UBOOT_ENTRYPOINT = "0x20008000"
UBOOT_LOADADDRESS = "0x20008000"

AT91BOOTSTRAP_MACHINE ?= "sama5d2_ptc_ek"
```

## conf/machine/sama5d2-xplained-sd.conf
```bitbake
#@TYPE: Machine
#@Name: ATMEL SAMA5D2 Xplained SD
#@DESCRIPTION: Machine configuration for Atmel's evaluation board

require include/sama5d2.inc

MACHINE_FEATURES = "apm alsa ext2 ext3 usbhost usbgadget screen touchscreen"
KERNEL_DEVICETREE = " \
		at91-sama5d2_xplained.dtb \
		"

IMAGE_FSTYPES += " tar.gz wic"

do_image_wic[depends] += "u-boot-at91:do_deploy"
WKS_FILE = "sdimage-bootpart.wks"
IMAGE_BOOT_FILES = "BOOT.BIN u-boot.bin sama5d2_xplained.itb"

UBOOT_MACHINE ?= "sama5d2_xplained_mmc_defconfig"
UBOOT_ENTRYPOINT = "0x20008000"
UBOOT_LOADADDRESS = "0x20008000"

AT91BOOTSTRAP_MACHINE ?= "sama5d2_xplained"

# Needed for FIT
MACHINE_ESSENTIAL_EXTRA_RDEPENDS = " dt-overlay-at91"
```

## conf/machine/sama5d2-xplained.conf
```bitbake
#@TYPE: Machine
#@Name: ATMEL SAMA5D2 Xplained
#@DESCRIPTION: Machine configuration for Atmel's evaluation board

require include/sama5d2.inc

MACHINE_FEATURES = "apm alsa ext2 ext3 usbhost usbgadget screen touchscreen"
KERNEL_DEVICETREE = " \
		at91-sama5d2_xplained.dtb \
		"
IMAGE_FSTYPES += " tar.gz wic"

WKS_FILE = "sdimage.wks"

# Install kernel and dtbs in rootfs that is on eMMC
IMAGE_INSTALL_append = " kernel-image kernel-devicetree"

UBOOT_MACHINE ?= "sama5d2_xplained_spiflash_defconfig"
UBOOT_ENTRYPOINT = "0x20008000"
UBOOT_LOADADDRESS = "0x20008000"

AT91BOOTSTRAP_MACHINE ?= "sama5d2_xplained"
```

## conf/machine/sama5d27-som1-ek-optee-sd.conf
```bitbake
#@TYPE: Machine
#@Name: ATMEL SAMA5D2 SOM1 EK OPTEE SD
#@DESCRIPTION: Machine configuration for Atmel/Microchip's evaluation board

require include/sama5d2.inc

MACHINE_FEATURES = "apm alsa ext2 ext3 usbhost usbgadget touchscreen"
KERNEL_DEVICETREE = " \
		at91-sama5d27_som1_ek.dtb \
		"

do_image_wic[depends] += "u-boot-at91:do_deploy"
IMAGE_FSTYPES += " tar.gz wic"
WKS_FILE = "sdimage-bootpart.wks"

IMAGE_BOOT_FILES = "BOOT.BIN u-boot.bin uboot.env sama5d27_som1_ek.itb tee.bin \
                    "
UBOOT_MACHINE ?= "sama5d27_som1_ek_mmc_optee_defconfig"
UBOOT_ENV_SIZE = "0x1000"

AT91BOOTSTRAP_MACHINE ?= "sama5d27_som1_ek"

# Needed for FIT
MACHINE_ESSENTIAL_EXTRA_RDEPENDS = " dt-overlay-mchp"
```

## conf/machine/sama5d27-som1-ek-sd.conf
```bitbake
#@TYPE: Machine
#@Name: ATMEL SAMA5D2 SOM1 EK SD
#@DESCRIPTION: Machine configuration for Atmel/Microchip's evaluation board

require include/sama5d2.inc

MACHINE_FEATURES = "apm alsa ext2 ext3 usbhost usbgadget touchscreen"
KERNEL_DEVICETREE = " \
		at91-sama5d27_som1_ek.dtb \
		"

do_image_wic[depends] += "u-boot-at91:do_deploy"
IMAGE_FSTYPES += " tar.gz wic"
WKS_FILE = "sdimage-bootpart.wks"
IMAGE_BOOT_FILES = "BOOT.BIN u-boot.bin sama5d27_som1_ek.itb"

UBOOT_MACHINE ?= "sama5d27_som1_ek_mmc_defconfig"
UBOOT_ENTRYPOINT = "0x20008000"
UBOOT_LOADADDRESS = "0x20008000"

AT91BOOTSTRAP_MACHINE ?= "sama5d27_som1_ek"

# Needed for FIT
MACHINE_ESSENTIAL_EXTRA_RDEPENDS = " dt-overlay-at91"
```

## conf/machine/sama5d29-curiosity-sd.conf
```bitbake
#@TYPE: Machine
#@Name: Microchip SAMA5D29-Curiosity micro SD
#@DESCRIPTION: Machine configuration for Microchip's board

require include/sama5d2.inc

MACHINE_FEATURES = "apm alsa ext2 ext3 usbhost usbgadget touchscreen"
KERNEL_DEVICETREE = " \
		at91-sama5d29_curiosity.dtb \
		"

do_image_wic[depends] += "u-boot-mchp:do_deploy"
IMAGE_FSTYPES += " tar.gz wic"
WKS_FILE = "sdimage-bootpart.wks"

IMAGE_BOOT_FILES = "BOOT.BIN u-boot.bin uboot.env sama5d29_curiosity.itb \
		   "

UBOOT_MACHINE ?= "sama5d29_curiosity_mmc_defconfig"
UBOOT_ENTRYPOINT = "0x20008000"
UBOOT_LOADADDRESS = "0x20008000"
UBOOT_ENV_SIZE = "0x4000"

AT91BOOTSTRAP_MACHINE ?= "sama5d29_curiosity"

# Needed for wic
EXTRA_IMAGEDEPENDS += "dosfstools-native mtools-native"

# Needed for FIT
MACHINE_ESSENTIAL_EXTRA_RDEPENDS = " dt-overlay-mchp"
```

## conf/machine/sama5d3-xplained-sd.conf
```bitbake
#@TYPE: Machine
#@Name: ATMEL SAMA5D3 Xplained SD
#@DESCRIPTION: Machine configuration for Atmel's evaluation board

require include/sama5d3.inc

MACHINE_FEATURES = "apm alsa ext2 ext3 usbhost usbgadget screen touchscreen wifi"
KERNEL_DEVICETREE = " \
		at91-sama5d3_xplained.dtb \
		"
IMAGE_FSTYPES += " tar.gz wic"

do_image_wic[depends] += "u-boot-at91:do_deploy"
WKS_FILE = "sdimage-bootpart.wks"
IMAGE_BOOT_FILES = "BOOT.BIN u-boot.bin sama5d3_xplained.itb"

# used by sysvinit_2
SERIAL_CONSOLES ?= "115200;ttyS0 115200;ttyGS0"

UBOOT_MACHINE ?= "sama5d3_xplained_mmc_defconfig"
UBOOT_ENTRYPOINT = "0x20008000"
UBOOT_LOADADDRESS = "0x20008000"

AT91BOOTSTRAP_MACHINE ?= "sama5d3_xplained"

# Needed for FIT
MACHINE_ESSENTIAL_EXTRA_RDEPENDS = " dt-overlay-at91"
```

## conf/machine/sama5d3-xplained.conf
```bitbake
#@TYPE: Machine
#@Name: ATMEL SAMA5D3 Xplained
#@DESCRIPTION: Machine configuration for Atmel's evaluation board

require include/sama5d3.inc

MACHINE_FEATURES = "apm alsa ext2 ext3 usbhost usbgadget screen touchscreen wifi"
KERNEL_DEVICETREE = " \
		at91-sama5d3_xplained.dtb \
		"

# used by sysvinit_2
SERIAL_CONSOLES ?= "115200;ttyS0 115200;ttyGS0"

IMAGE_FSTYPES += " ubi tar.gz"

# NAND
MKUBIFS_ARGS ?= " -e 0x1f000 -c 2048 -m 0x800  -x lzo"
UBINIZE_ARGS ?= " -m 0x800 -p 0x20000 -s 2048"

UBI_VOLNAME = "rootfs"

UBOOT_MACHINE ?= "sama5d3_xplained_nandflash_config"
UBOOT_ENTRYPOINT = "0x20008000"
UBOOT_LOADADDRESS = "0x20008000"

AT91BOOTSTRAP_MACHINE ?= "sama5d3_xplained"
```

## conf/machine/sama5d31ek.conf
```bitbake
#@TYPE: Machine
#@Name: ATMEL SAMA5D31ek
#@DESCRIPTION: Machine configuration for Atmel's evaluation board

require conf/machine/include/sama5d3xek.inc

KERNEL_DEVICETREE = " \
		sama5d31ek.dtb \
		sama5d31ek_pda4.dtb \
		sama5d31ek_pda7.dtb \
		sama5d31ek_revc.dtb \
		sama5d31ek_revc_pda4.dtb \
		sama5d31ek_revc_pda7.dtb \
		"
```

## conf/machine/sama5d33ek.conf
```bitbake
#@TYPE: Machine
#@Name: ATMEL SAMA5D33ek
#@DESCRIPTION: Machine configuration for Atmel's evaluation board

require conf/machine/include/sama5d3xek.inc

KERNEL_DEVICETREE = " \
		sama5d33ek.dtb \
		sama5d33ek_pda4.dtb \
		sama5d33ek_pda7.dtb \
		sama5d33ek_revc.dtb \
		sama5d33ek_revc_pda4.dtb \
		sama5d33ek_revc_pda7.dtb \
		"
```

## conf/machine/sama5d34ek.conf
```bitbake
#@TYPE: Machine
#@Name: ATMEL SAMA5D34ek
#@DESCRIPTION: Machine configuration for Atmel's evaluation board

require conf/machine/include/sama5d3xek.inc

KERNEL_DEVICETREE = " \
		sama5d34ek.dtb \
		sama5d34ek_pda4.dtb \
		sama5d34ek_pda7.dtb \
		sama5d34ek_revc.dtb \
		sama5d34ek_revc_pda4.dtb \
		sama5d34ek_revc_pda7.dtb \
		"
```

## conf/machine/sama5d35ek.conf
```bitbake
#@TYPE: Machine
#@Name: ATMEL SAMA5D35ek
#@DESCRIPTION: Machine configuration for Atmel's evaluation board

require conf/machine/include/sama5d3xek.inc

KERNEL_DEVICETREE = " \
		sama5d35ek.dtb \
		sama5d35ek_revc.dtb \
		"
```

## conf/machine/sama5d36ek.conf
```bitbake
#@TYPE: Machine
#@Name: ATMEL SAMA5D36ek
#@DESCRIPTION: Machine configuration for Atmel's evaluation board

require conf/machine/include/sama5d3xek.inc

KERNEL_DEVICETREE = " \
		sama5d36ek.dtb \
		sama5d36ek_pda4.dtb \
		sama5d36ek_pda7.dtb \
		sama5d36ek_revc.dtb \
		sama5d36ek_revc_pda4.dtb \
		sama5d36ek_revc_pda7.dtb \
		"
```

## conf/machine/sama5d3_xplained.conf
```bitbake
#@TYPE: Machine
#@Name: ATMEL SAMA5D3 Xplained
#@DESCRIPTION: Machine configuration for Atmel's evaluation board

require conf/machine/include/sama5d3x.inc

MACHINE_FEATURES += "wifi"

KERNEL_DEVICETREE = " \
		at91-sama5d3_xplained.dtb \
		at91-sama5d3_xplained_pda4.dtb \
		at91-sama5d3_xplained_pda7.dtb \
		"

# used by sysvinit_2
SERIAL_CONSOLES ?= "115200;ttyS0 115200;ttyGS0"

ROOT_FLASH_SIZE = "256"
IMAGE_FSTYPES += " ubi tar.gz"

# NAND
MKUBIFS_ARGS = " -e 0x1f000 -c 2048 -m 0x800  -x lzo"
UBINIZE_ARGS = " -m 0x800 -p 0x20000 -s 2048"

UBI_VOLNAME = "rootfs"

UBOOT_MACHINE = "sama5d3xek_nandflash_config"
```

## conf/machine/sama5d3xek.conf
```bitbake
#@TYPE: Machine
#@Name: ATMEL SAMA5D3xek
#@DESCRIPTION: Machine configuration for Atmel's evaluation board

require include/sama5d3.inc

MACHINE_FEATURES = "apm alsa ext2 ext3 usbhost usbgadget screen touchscreen"
KERNEL_DEVICETREE = " \
		sama5d31ek.dtb \
		sama5d33ek.dtb \
		sama5d34ek.dtb \
		sama5d35ek.dtb \
		sama5d36ek.dtb \
		"

IMAGE_FSTYPES += " ubi tar.gz"

# NAND
MKUBIFS_ARGS = " -e 0x1f000 -c 2048 -m 0x800  -x lzo"
UBINIZE_ARGS = " -m 0x800 -p 0x20000 -s 2048"

UBI_VOLNAME = "rootfs"

UBOOT_MACHINE ?= "${MACHINE}_nandflash_config"
UBOOT_ENTRYPOINT = "0x20008000"
UBOOT_LOADADDRESS = "0x20008000"
UBOOT_FIT_IMAGE = "xyes"
```

## conf/machine/sama5d4-xplained-sd.conf
```bitbake
#@TYPE: Machine
#@Name: ATMEL SAMA5D4 Xplained Ultra SD
#@DESCRIPTION: Machine configuration for Atmel's evaluation board

require include/sama5d4.inc

MACHINE_FEATURES = "apm alsa ext2 ext3 usbhost usbgadget screen touchscreen"
KERNEL_DEVICETREE = " \
		at91-sama5d4_xplained.dtb \
		"

IMAGE_FSTYPES += " tar.gz wic"

do_image_wic[depends] += "u-boot-at91:do_deploy"
WKS_FILE = "sdimage-bootpart.wks"
IMAGE_BOOT_FILES = "BOOT.BIN u-boot.bin sama5d4_xplained.itb"

UBOOT_MACHINE ?= "sama5d4_xplained_mmc_defconfig"
UBOOT_ENTRYPOINT = "0x20008000"
UBOOT_LOADADDRESS = "0x20008000"

AT91BOOTSTRAP_MACHINE ?= "sama5d4_xplained"

# Needed for FIT
MACHINE_ESSENTIAL_EXTRA_RDEPENDS = " dt-overlay-at91"
```

## conf/machine/sama5d4-xplained.conf
```bitbake
#@TYPE: Machine
#@Name: ATMEL SAMA5D4 Xplained Ultra
#@DESCRIPTION: Machine configuration for Atmel's evaluation board

require include/sama5d4.inc

MACHINE_FEATURES = "apm alsa ext2 ext3 usbhost usbgadget screen touchscreen"
KERNEL_DEVICETREE = " \
		at91-sama5d4_xplained.dtb \
		"

IMAGE_FSTYPES += " ubi tar.gz"

# NAND
MKUBIFS_ARGS = " -e 0x3e000 -c 2082 -m 0x1000 -x lzo"
UBINIZE_ARGS = " -m 0x1000 -p 0x40000"

UBI_VOLNAME = "rootfs"

UBOOT_MACHINE ?= "sama5d4_xplained_nandflash_config"
UBOOT_ENTRYPOINT = "0x20008000"
UBOOT_LOADADDRESS = "0x20008000"

AT91BOOTSTRAP_MACHINE ?= "sama5d4_xplained"
```

## conf/machine/sama5d4ek.conf
```bitbake
#@TYPE: Machine
#@Name: ATMEL SAMA5D4ek
#@DESCRIPTION: Machine configuration for Atmel's evaluation board

require conf/machine/include/tune-cortexa5.inc
require conf/machine/include/bootloaders.inc

MACHINE_FEATURES = "kernel26 apm alsa ext2 ext3 usbhost usbgadget screen camera can touchscreen ppp"
KERNEL_DEVICETREE = " \
		sama5d4ek.dtb \
		"

PREFERRED_PROVIDER_virtual/kernel = "linux-yocto-custom"
PREFERRED_PROVIDER_virtual/bootloader = "u-boot-at91"

PREFERRED_PROVIDER_jpeg = "jpeg"
PREFERRED_PROVIDER_jpeg-native = "jpeg-native"

ALLOW_EMPTY_qttools-plugins = "1"

DEFAULTTUNE = "cortexa5thf-neon"

# used by sysvinit_2
SERIAL_CONSOLE ?= "115200 ttyS0"

ROOT_FLASH_SIZE = "256"
IMAGE_FSTYPES += " ubi tar.gz"

# NAND
MKUBIFS_ARGS = " -e 0x3e000 -c 2082 -m 0x1000 -x lzo"
UBINIZE_ARGS = " -m 0x1000 -p 0x40000"

UBI_VOLNAME = "rootfs"

UBOOT_MACHINE ?= "${MACHINE}_nandflash_config"
UBOOT_ENTRYPOINT = "0x20008000"
UBOOT_LOADADDRESS = "0x20008000"
```

## conf/machine/sama7d65-curiosity-sd.conf
```bitbake
#@TYPE: Machine
#@Name: Microchip SAMA7D65-CURIOSITY SD
#@DESCRIPTION: Machine configuration for Microchip's evaluation kit board

require include/sama7d65.inc

MACHINE_FEATURES = "apm alsa ext2 ext3 usbhost usbgadget"
KERNEL_DEVICETREE = " \
		at91-sama7d65_curiosity.dtb \
		"

IMAGE_FSTYPES += " tar.gz wic"

do_image_wic[depends] += "u-boot-mchp:do_deploy"
WKS_FILE = "sdimage-bootpart.wks"
IMAGE_BOOT_FILES = "BOOT.BIN u-boot.bin uboot.env sama7d65_curiosity.itb"

UBOOT_MACHINE ?= "sama7d65_curiosity_mmc1_defconfig"
UBOOT_ENTRYPOINT = "0x62000000"
UBOOT_LOADADDRESS = "0x62000000"
UBOOT_ENV_SIZE = "0x4000"

AT91BOOTSTRAP_MACHINE ?= "sama7d65_curiosity"

# Needed for FIT
MACHINE_ESSENTIAL_EXTRA_RDEPENDS = " dt-overlay-mchp"

MACHINEOVERRIDES =. "sama7d65:"
```
