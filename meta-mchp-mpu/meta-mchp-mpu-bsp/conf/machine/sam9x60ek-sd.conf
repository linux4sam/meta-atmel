## meta-mchp-mpu/meta-mchp-mpu-bsp/conf/machine/sam9x60ek-sd.conf
```bitbake
#@TYPE: Machine
#@Name: MICROCHIP SAM9X60-EK SD
#@DESCRIPTION: Machine configuration for Microchip SAM9X60 sd evaluation kit

require include/sam9x60.inc

MACHINE_FEATURES += " wifi"
KERNEL_DEVICETREE = "microchip/at91-sam9x60ek.dtb"
DT_MACHINE ?= "sam9x60ek"

IMAGE_FSTYPES += " tar.gz wic"

WKS_FILE = "sdimage-bootpart.wks"

IMAGE_BOOT_FILES = "BOOT.BIN u-boot.bin uboot.env sam9x60ek.itb"

UBOOT_MACHINE ?= "sam9x60ek_mmc_defconfig"
UBOOT_ENTRYPOINT = "0x20008000"
UBOOT_LOADADDRESS = "0x20008000"
UBOOT_ENV_SIZE = "0x4000"

# Needed for wic
EXTRA_IMAGEDEPENDS += "dosfstools-native mtools-native"

MACHINE_ESSENTIAL_EXTRA_RDEPENDS += " dt-overlay-mchp"

# Add deploy functions to the wic image dependency
do_image_wic[depends] += " u-boot-mchp:do_deploy"
do_image_wic[depends] += " dt-overlay-mchp:do_deploy"

MACHINEOVERRIDES =. "mpuall:sam9x60ek:"
```

## meta-mchp-mpu/meta-mchp-mpu-bsp/conf/machine/sama5d2-icp-sd.conf
```bitbake
#@TYPE: Machine
#@Name: MICROCHIP SAMA5D2-ICP SD
#@DESCRIPTION: Machine configuration for Microchip SAMA5D2-ICP sd board

require include/sama5d2.inc

MACHINE_FEATURES = "apm ext2 ext3 usbhost usbgadget"
KERNEL_DEVICETREE = "microchip/at91-sama5d2_icp.dtb"
DT_MACHINE ?= "sama5d2_icp"

IMAGE_FSTYPES += " tar.gz wic"

WKS_FILE = "sdimage-bootpart.wks"

IMAGE_BOOT_FILES = "BOOT.BIN u-boot.bin uboot.env sama5d2_icp.itb"

UBOOT_MACHINE ?= "sama5d2_icp_mmc_defconfig"
UBOOT_ENTRYPOINT = "0x20008000"
UBOOT_LOADADDRESS = "0x20008000"
UBOOT_ENV_SIZE = "0x4000"

MACHINE_ESSENTIAL_EXTRA_RDEPENDS += " dt-overlay-mchp"

# Add deploy functions to the wic image dependency
do_image_wic[depends] += " u-boot-mchp:do_deploy"
do_image_wic[depends] += " dt-overlay-mchp:do_deploy"

MACHINEOVERRIDES =. "mpuall:sama5d2_icp:"
```

## meta-mchp-mpu/meta-mchp-mpu-bsp/conf/machine/sama5d3-xplained-sd.conf
```bitbake
#@TYPE: Machine
#@Name: MICROCHIP SAMA5D3 Xplained SD
#@DESCRIPTION: Machine configuration for Microchip SAMA5D3 xplained sd board

require include/sama5d3.inc

MACHINE_FEATURES += " wifi"
KERNEL_DEVICETREE = "microchip/at91-sama5d3_xplained.dtb"
DT_MACHINE ?= "sama5d3_xplained"

IMAGE_FSTYPES += " tar.gz wic"

WKS_FILE = "sdimage-bootpart.wks"
IMAGE_BOOT_FILES = "BOOT.BIN u-boot.bin uboot.env sama5d3_xplained.itb"

# used by sysvinit_2
SERIAL_CONSOLES ?= "115200;ttyS0 115200;ttyGS0"

UBOOT_MACHINE ?= "sama5d3_xplained_mmc_defconfig"
UBOOT_ENTRYPOINT = "0x20008000"
UBOOT_LOADADDRESS = "0x20008000"
UBOOT_ENV_SIZE = "0x4000"

MACHINE_ESSENTIAL_EXTRA_RDEPENDS += " dt-overlay-mchp"

# Add deploy functions to the wic image dependency
do_image_wic[depends] += " u-boot-mchp:do_deploy"
do_image_wic[depends] += " dt-overlay-mchp:do_deploy"

MACHINEOVERRIDES =. "mpuall:sama5d3_xplained:"
```

## meta-mchp-mpu/meta-mchp-mpu-bsp/conf/machine/sama7d65-curiosity-pro-sd.conf
```bitbake
#@TYPE: Machine
#@Name: Microchip SAMA7D65-CURIOSITY-PRO SD
#@DESCRIPTION: Machine configuration for Microchip SAMA7D65 curiosity pro sd board

require include/sama7d65.inc

MACHINE_FEATURES = "apm alsa ext2 ext3 usbhost usbgadget"
KERNEL_DEVICETREE = "microchip/at91-sama7d65_curiosity_pro.dtb"
DT_MACHINE ?= "sama7d65_curiosity_pro"

IMAGE_FSTYPES += " tar.gz wic"

WKS_FILE = "sdimage-bootpart.wks"
IMAGE_BOOT_FILES = "BOOT.BIN u-boot.bin uboot.env sama7d65_curiosity_pro.itb"

UBOOT_MACHINE ?= "sama7d65_curiosity_pro_mmc1_defconfig"
UBOOT_ENTRYPOINT = "0x62000000"
UBOOT_LOADADDRESS = "0x62000000"
UBOOT_ENV_SIZE = "0x4000"

MACHINE_ESSENTIAL_EXTRA_RDEPENDS += " dt-overlay-mchp"

# Add deploy functions to the wic image dependency
do_image_wic[depends] += " u-boot-mchp:do_deploy"
do_image_wic[depends] += " dt-overlay-mchp:do_deploy"

MACHINEOVERRIDES =. "mpuall:sama7d65:"
```

## meta-mchp-polarfire-soc/meta-mchp-polarfire-soc-bsp/conf/machine/mpfs-icicle-kit-prod-auth.conf
```bitbake
#@TYPE: Machine
#@NAME: mpfs-icicle-kit-prod-auth
#@SOC: Polarfire SoC
#@DESCRIPTION: Machine configuration for the Microchip Polarfire SoC Icicle Kit with authenticated boot

require include/mpfs-common.inc

MACHINE_TYPE = "smp"

MACHINE_FEATURES:append = " pci usbgadget usbhost wifi"

RISCV_SBI_FDT ?=  "mpfs-icicle-kit-prod.dtb"
KERNEL_DTC_FLAGS += "-@"
KERNEL_DEVICETREE ?= "microchip/${RISCV_SBI_FDT}"

UBOOT_MACHINE = "microchip_mpfs_icicle_defconfig"

HSS_PAYLOAD = "uboot"

UBOOT_SIGN_ENABLE = "1"
UBOOT_SIGN_KEYNAME ?= "mpfs_fitimage_key"
UBOOT_SIGN_KEYDIR ?= "${TOPDIR}/../keys"
UBOOT_MKIMAGE_DTCOPTS = "-I dts -O dtb -p 2000"

FIT_SIGN_ALG = "rsa4096"
FIT_HASH_ALG = "sha256"

HSS_PAYLOAD_PRIVATE_KEYNAME ?= "x509-ec-secp384r1-private"
HSS_PAYLOAD_KEYDIR ?= "${TOPDIR}/../keys"

INITRAMFS_IMAGE = "mchp-initramfs-image"

IMAGE_BOOT_FILES ?= " \
    fitImage \
"

WKS_FILE ?= "mpfs-rootfs.wks"

MACHINEOVERRIDES .= ":mpfs:mpfs-icicle-kit-all::mpfs-icicle-kit-auth"
```
