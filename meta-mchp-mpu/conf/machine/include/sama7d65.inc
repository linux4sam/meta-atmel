## meta-mchp-mpu/conf/machine/include/sama7d65.inc
```bitbake
# Microchip SAMA7G5 defaults
require sama7.inc

SOC_FAMILY = "sama7:sama7d65"

DEFAULTTUNE = "cortexa7hf-neon-vfpv4"
```

## meta-mchp-mpu/conf/machine/sam9x60-curiosity-sd.conf
```bitbake
#@TYPE: Machine
#@Name: MICROCHIP SAM9X60-CURIOSITY SD
#@DESCRIPTION: Machine configuration for Microchip SAM9X60 curiosity sd board

require include/sam9x60.inc

KERNEL_DEVICETREE = "microchip/at91-sam9x60_curiosity.dtb"
DT_MACHINE ?= "sam9x60_curiosity"

IMAGE_FSTYPES += " tar.gz wic"

WKS_FILE = "sdimage-bootpart.wks"

IMAGE_BOOT_FILES = "BOOT.BIN u-boot.bin uboot.env sam9x60_curiosity.itb"

UBOOT_MACHINE ?= "sam9x60_curiosity_mmc_defconfig"
UBOOT_ENTRYPOINT = "0x20008000"
UBOOT_LOADADDRESS = "0x20008000"
UBOOT_ENV_SIZE = "0x4000"

# Needed for wic
EXTRA_IMAGEDEPENDS += "dosfstools-native mtools-native"

MACHINE_ESSENTIAL_EXTRA_RDEPENDS += " dt-overlay-mchp"

# Add deploy functions to the wic image dependency
do_image_wic[depends] += " u-boot-mchp:do_deploy"
do_image_wic[depends] += " dt-overlay-mchp:do_deploy"

MACHINEOVERRIDES =. "sam9x60_curiosity:"
```

## meta-mchp-mpu/meta-mchp-mpu-bsp/conf/machine/include/common-conf.inc
```bitbake
# Common to all machines in mpu
MACHINE_FEATURES += " apm alsa ext2 ext3 usbhost usbgadget screen touchscreen"

#Add a sdmmc feature to identify mpu machines with sd or emmc
MACHINE_FEATURES:append = "${@' sdmmc' if '-sd' in d.getVar('MACHINE') or '-emmc' in d.getVar('MACHINE') else ''}"
MACHINEOVERRIDES:append = "${@bb.utils.contains('MACHINE_FEATURES', 'sdmmc', ':autoresize', '', d)}"

# Add bootloaders to the images of every machine
EXTRA_IMAGEDEPENDS += " at91bootstrap virtual/bootloader"
```

## meta-mchp-mpu/meta-mchp-mpu-bsp/conf/machine/include/sam9x60.inc
```bitbake
# Microchip SAM9X60 defaults
require at91sam9.inc

SOC_FAMILY = "at91sam9:sam9x60"
```

## meta-mchp-mpu/meta-mchp-mpu-bsp/conf/machine/include/sam9x75.inc
```bitbake
# Microchip SAM9X75 defaults
require at91sam9.inc

SOC_FAMILY = "at91sam9:sam9x75"
```

## meta-mchp-mpu/meta-mchp-mpu-bsp/conf/machine/include/sama7g5.inc
```bitbake
# Microchip SAMA7G5 defaults
require sama7.inc

SOC_FAMILY = "sama7:sama7g5"

DEFAULTTUNE = "cortexa7hf-neon-vfpv4"
```

## meta-mchp-pic64/conf/machine/include/pic64gx-common.inc
```bitbake
#@TYPE: Machine Include
#@SOC: PIC64GX
#@DESCRIPTION: Common Machine Configuration for PIC64GX

require conf/machine/include/riscv/tune-riscv.inc

MACHINE_FEATURES = "screen keyboard ext2 ext3 serial pci usbhost wifi"

#Add a sdmc feature to identify pic64 machines with sd or emmc
MACHINE_FEATURES:append = "${@' sdmmc' if '-nand' not in d.getVar('MACHINE') and '-nor' not in d.getVar('MACHINE') else ''}"
MACHINEOVERRIDES:append = "${@bb.utils.contains('MACHINE_FEATURES', 'sdmmc', ':autoresize', '', d)}"

KERNEL_CLASSES = "kernel-fitimage"
KERNEL_IMAGETYPE = "fitImage"
EXTERNAL_KERNEL_DEVICETREE = "${DEPLOY_DIR_IMAGE}/overlays"

KBUILD_DEFCONFIG ?= "mpfs_defconfig"

PREFERRED_PROVIDER_virtual/kernel ?= "linux-mchp"
PREFERRED_VERSION_openocd-native = "riscv"
PREFERRED_VERSION_openocd = "riscv"
PREFERRED_PROVIDER_virtual/bootloader = "u-boot-mchp"
PREFERRED_PROVIDER_u-boot = "u-boot-mchp"
PREFERRED_VERSION_libgpiod = "1.6.4"

PREFERRED_VERSION_u-boot-mchp = "v2025.07%"

UBOOT_ENTRYPOINT = "0x80200000"
UBOOT_DTB_LOADADDRESS = "0x8a000000"
UBOOT_DTBO_LOADADDRESS = "0x8a080000"
UBOOT_RD_LOADADDRESS = "0x8aa00000"
UBOOT_RD_ENTRYPOINT = "0x8aa00000"

MACHINE_EXTRA_RRECOMMENDS += " kernel-modules"

IMAGE_FSTYPES += "wic wic.gz wic.bmap ext4"

## Do not update fstab file when using wic images
WIC_CREATE_EXTRA_ARGS ?= "--no-fstab-update"

IMAGE_INSTALL:append = " dt-overlay-mchp"

## wic default support
WKS_FILE_DEPENDS ?= " \
    e2fsprogs-native \
    bmaptool-native \
    u-boot-mchp \
"
```

## meta-mchp-pic64/conf/machine/pic64gx-curiosity-kit.conf
```bitbake
#@TYPE: Machine
#@NAME: pic64gx-curiosity-kit
#@SOC: PIC64GX
#@DESCRIPTION: Machine configuration for the Microchip PIC64GX, Curiosity kit

require include/pic64gx-common.inc

MACHINE_TYPE = "smp"

RISCV_SBI_FDT ?=  "pic64gx-curiosity-kit.dtb"
KERNEL_DTC_FLAGS += "-@"
KERNEL_DEVICETREE ?= "microchip/${RISCV_SBI_FDT}"

UBOOT_MACHINE = "microchip_pic64gx_curiosity_kit_defconfig"

## Generate a boot.scr file which should be included
##  in the boot partition. It will try to load a kernel image from mmc
UBOOT_ENV = "boot"
UBOOT_ENV_SUFFIX = "scr"
UBOOT_ENV_SIZE = "0x2000"

HSS_PAYLOAD = "uboot"

IMAGE_BOOT_FILES ?= " \
    fitImage \
    boot.scr \
    uboot.env \
"

WKS_FILE ?= "pic64gx-rootfs.wks"

MACHINEOVERRIDES =. "pic64gx-curiosity-kit:"

MACHINEOVERRIDES .= ":pic64gx"
```

## meta-mchp-polarfire-soc/meta-mchp-polarfire-soc-bsp/conf/machine/include/mpfs-common.inc
```bitbake
#@TYPE: Machine Include
#@SOC: Polarfire SoC
#@DESCRIPTION: Common Machine Configuration for Polarfire SoC

require conf/machine/include/riscv/tune-riscv.inc

MACHINE_FEATURES = "screen keyboard ext2 ext3 serial"

KERNEL_CLASSES = "kernel-fitimage"
KERNEL_IMAGETYPE = "fitImage"
EXTERNAL_KERNEL_DEVICETREE = "${DEPLOY_DIR_IMAGE}/overlays"

KBUILD_DEFCONFIG = "mpfs_defconfig"

PREFERRED_PROVIDER_virtual/kernel ?= "linux-mchp"
PREFERRED_VERSION_linux-mchp = "6.6%"

PREFERRED_VERSION_openocd-native = "riscv"
PREFERRED_VERSION_openocd = "riscv"

PREFERRED_PROVIDER_virtual/bootloader = "u-boot-mchp"
PREFERRED_PROVIDER_u-boot = "u-boot-mchp"
PREFERRED_VERSION_u-boot-mchp = "v2023.07%"

PREFERRED_VERSION_libgpiod = "1.6.4"

UBOOT_ENTRYPOINT = "0x80200000"
UBOOT_DTB_LOADADDRESS = "0x8a000000"
UBOOT_DTBO_LOADADDRESS = "0x8a080000"
UBOOT_RD_LOADADDRESS = "0x8aa00000"
UBOOT_RD_ENTRYPOINT = "0x8aa00000"

SSTATE_ALLOW_OVERLAP_FILES += "${DEPLOY_DIR_SPDX}"

MACHINE_EXTRA_RRECOMMENDS += " kernel-modules"

IMAGE_FSTYPES += "wic wic.gz wic.bmap ext4"

## Do not update fstab file when using wic images
WIC_CREATE_EXTRA_ARGS ?= "--no-fstab-update"

IMAGE_INSTALL:append = " dt-overlay-mchp"

## wic default support
WKS_FILE_DEPENDS ?= " \
    e2fsprogs-native \
    bmaptool-native \
    u-boot-mchp \
"
```

## meta-mchp-polarfire-soc/meta-mchp-polarfire-soc-bsp/conf/machine/mpfs-disco-kit.conf
```bitbake
#@TYPE: Machine
#@NAME: mpfs-disco-kit
#@SOC: Polarfire SoC
#@DESCRIPTION: Machine configuration for the Microchip Polarfire SoC, Discovery kit

require include/mpfs-common.inc

MACHINE_TYPE = "smp"

RISCV_SBI_FDT ?=  "mpfs-disco-kit.dtb"
KERNEL_DTC_FLAGS += "-@"
KERNEL_DEVICETREE ?= "microchip/${RISCV_SBI_FDT}"

UBOOT_MACHINE = "microchip_mpfs_discokit_defconfig"

IMAGE_INSTALL:remove = " dt-overlay-mchp"

## Generate a boot.scr file which should be included
##  in the boot partition. It will try to load a kernel image from mmc
UBOOT_ENV = "boot"
UBOOT_ENV_SUFFIX = "scr"
UBOOT_ENV_SIZE = "0x2000"

HSS_PAYLOAD = "uboot"

IMAGE_BOOT_FILES ?= " \
    fitImage \
    boot.scr \
    uboot.env \
"

WKS_FILE ?= "mpfs-rootfs.wks"
```

## meta-mchp-polarfire-soc/meta-mchp-polarfire-soc-bsp/conf/machine/mpfs-icicle-kit-es-amp.conf
```bitbake
#@TYPE: Machine
#@NAME: mpfs-icicle-kit-es-amp
#@SOC: Polarfire SoC
#@DESCRIPTION: Machine configuration for the Microchip Polarfire SoC, Icicle Kit Engineering Sample in AMP mode

require include/mpfs-common.inc

MACHINE_TYPE = "amp"

MACHINE_FEATURES:append = "pci usbgadget usbhost wifi"

RISCV_SBI_FDT ?=  "mpfs-icicle-kit.dtb"
KERNEL_DTC_FLAGS += "-@"
KERNEL_DEVICETREE ?= "microchip/${RISCV_SBI_FDT}"

UBOOT_MACHINE = "microchip_mpfs_icicle_amp_defconfig"

## Generate a boot.scr file which should be included
##  in the boot partition. It will try to load a kernel image from mmc
UBOOT_ENV = "boot"
UBOOT_ENV_SUFFIX = "scr"
UBOOT_ENV_SIZE = "0x2000"

## Select the YAML file used for building the HSS payload
HSS_PAYLOAD = "amp"

## Set this to "freertos" for a Linux + FreeRTOS demo or "bm" for a Linux + Bare Metal demo
AMP_DEMO = "freertos"
#AMP_DEMO = "bm"

IMAGE_INSTALL:append = " polarfire-soc-amp-examples"

IMAGE_BOOT_FILES ?= " \
    fitImage \
    boot.scr \
    uboot.env \
"

WKS_FILE ?= "mpfs-rootfs.wks"

MACHINEOVERRIDES .= ":mpfs-icicle-kit-all"
```

## meta-mchp-polarfire-soc/meta-mchp-polarfire-soc-bsp/conf/machine/mpfs-icicle-kit-es-nand.conf
```bitbake
#@TYPE: Machine
#@NAME: mpfs-icicle-kit-es-nand
#@SOC: Polarfire SoC
#@DESCRIPTION: Machine configuration for the Microchip Polarfire SoC, Icicle Kit Engineering Sample

require include/mpfs-common.inc

MACHINE_TYPE = "smp"

MACHINE_FEATURES:append = "pci usbgadget usbhost wifi"

RISCV_SBI_FDT ?=  "mpfs-icicle-kit.dtb"
KERNEL_DTC_FLAGS += "-@"
KERNEL_DEVICETREE ?= "microchip/${RISCV_SBI_FDT}"

UBOOT_MACHINE = "microchip_mpfs_icicle_defconfig"

# UBIFS for Mikroe FLash 5 Click (128 MB)
MKUBIFS_ARGS ?= " -e 126976 -c 926 -m 2048 -x zlib -F"
UBINIZE_ARGS ?= " -m 2048 -p 128KiB -s 2048"

MPFS_MTDPARTS = "spi2.0:2m(payload),119m(ubi)"
MPFS_IS_ON_MTDID = "spi2.0"
MPFS_MTD_TYPE = "nand"
UBI_VOLNAME = "ubi"

IMAGE_CLASSES:append = " image_type_mtd image_type-ubimage"
IMAGE_FSTYPES = "  mtd ubifs ubimg"
UBI_ROOTFS_SIZE = "16"

UBOOT_ENV = "boot"
UBOOT_ENV_SUFFIX = "scr"
UBOOT_ENV_SIZE = "0x2000"

HSS_PAYLOAD = "uboot"

IMAGE_BOOT_FILES ?= " \
    fitImage \
    boot.scr \
"

WKS_FILE ?= "mpfs-rootfs.wks"

MACHINEOVERRIDES .= ":mpfs-icicle-kit-all"
```

## meta-mchp-polarfire-soc/meta-mchp-polarfire-soc-bsp/conf/machine/mpfs-icicle-kit-es-nor.conf
```bitbake
#@TYPE: Machine
#@NAME: mpfs-icicle-kit-es-nor
#@SOC: Polarfire SoC
#@DESCRIPTION: Machine configuration for the Microchip Polarfire SoC, Icicle Kit Engineering Sample

require include/mpfs-common.inc

MACHINE_TYPE = "smp"

MACHINE_FEATURES:append = "pci usbgadget usbhost wifi"

RISCV_SBI_FDT ?=  "mpfs-icicle-kit.dtb"
KERNEL_DTC_FLAGS += "-@"
KERNEL_DEVICETREE ?= "microchip/${RISCV_SBI_FDT}"

UBOOT_MACHINE = "microchip_mpfs_icicle_qspi_nor_defconfig"

# UBIFS for PMOD SF3 NOR Flash + Pmod HAT Adapter (32 MB)
MKUBIFS_ARGS ?= " -e 65408 -c 422 -m 1 -x zlib"
UBINIZE_ARGS ?= " -m 1 -p 64KiB"

# The 32MB PMOD SF3 NOR Flash is too small for latest systemd versions
# use sysvinit for this machine only. This can be commented for
# other NOR flashes with larger capacity.
DISTRO_FEATURES:remove = " systemd"
DISTRO_FEATURES:append = " sysvinit"
VIRTUAL-RUNTIME_init_manager = "sysvinit"
VIRTUAL-RUNTIME_initscripts = "initscripts"
VIRTUAL-RUNTIME_login_manager = "busybox"
VIRTUAL-RUNTIME_base-utils-hwclock = "util-linux-hwclock"

# Used by sysvinit
SERIAL_CONSOLES = "115200;ttyS1"

MPFS_MTDPARTS = "spi2.0:2m(payload),28m(ubi)"
MPFS_IS_ON_MTDID = "spi2.0"
MPFS_MTD_TYPE = "nor"
UBI_VOLNAME = "ubi"

IMAGE_CLASSES:append = " image_type_mtd image_type-ubimage"
IMAGE_FSTYPES = "  mtd ubifs ubimg"
UBI_ROOTFS_SIZE = "16"

UBOOT_ENV = "boot"
UBOOT_ENV_SUFFIX = "scr"
UBOOT_ENV_SIZE = "0x2000"

HSS_PAYLOAD = "uboot"

PREFERRED_VERSION_systemd = "250.5"

IMAGE_BOOT_FILES ?= " \
    fitImage \
    boot.scr \
"

WKS_FILE ?= "mpfs-rootfs.wks"

MACHINEOVERRIDES .= ":mpfs-icicle-kit-all"
```

## meta-mchp-polarfire-soc/meta-mchp-polarfire-soc-bsp/conf/machine/mpfs-icicle-kit-es.conf
```bitbake
#@TYPE: Machine
#@NAME: mpfs-icicle-kit-es
#@SOC: Polarfire SoC
#@DESCRIPTION: Machine configuration for the Microchip Polarfire SoC, Icicle Kit Engineering Sample

require include/mpfs-common.inc

MACHINE_TYPE = "smp"

MACHINE_FEATURES:append = " pci usbgadget usbhost wifi"

RISCV_SBI_FDT ?=  "mpfs-icicle-kit.dtb"
KERNEL_DTC_FLAGS += "-@"
KERNEL_DEVICETREE ?= "microchip/${RISCV_SBI_FDT}"

UBOOT_MACHINE = "microchip_mpfs_icicle_defconfig"

## Generate a boot.scr file which should be included
##  in the boot partition. It will try to load a kernel image from mmc
UBOOT_ENV = "boot"
UBOOT_ENV_SUFFIX = "scr"
UBOOT_ENV_SIZE = "0x2000"

HSS_PAYLOAD = "uboot"

IMAGE_BOOT_FILES ?= " \
    fitImage \
    boot.scr \
    uboot.env \
"

WKS_FILE ?= "mpfs-rootfs.wks"

MACHINEOVERRIDES .= ":mpfs-icicle-kit-all"
```

## meta-mchp-polarfire-soc/meta-mchp-polarfire-soc-bsp/conf/machine/mpfs-video-kit.conf
```bitbake
#@TYPE: Machine
#@NAME: mpfs-video-kit
#@SOC: Polarfire SoC
#@DESCRIPTION: Machine configuration for the Microchip Polarfire SoC Video Kit

require include/mpfs-common.inc
MACHINE_TYPE = "smp"

MACHINE_FEATURES:append = "pci usbgadget usbhost wifi"

RISCV_SBI_FDT ?=  "mpfs-video-kit.dtb"
KERNEL_DTC_FLAGS += "-@"
KERNEL_DEVICETREE ?= "microchip/${RISCV_SBI_FDT}"

UBOOT_MACHINE="microchip_mpfs_videokit_defconfig"
UBOOT_DEVICE_TREE ?= "mpfs_video.dtb"

## Generate a boot.scr file which should be included
##  in the boot partition. It will try to load a kernel image from mmc
UBOOT_ENV = "boot"
UBOOT_ENV_SUFFIX = "scr"
UBOOT_ENV_SIZE = "0x2000"

HSS_PAYLOAD = "uboot"

IMAGE_BOOT_FILES ?= " \
    fitImage \
    boot.scr \
    uboot.env \
"

PREFERRED_VERSION_cryptodev-linux = "1.13%"
PREFERRED_VERSION_cryptodev-module = "1.13%"
PREFERRED_VERSION_cryptodev-tests = "1.13%"

WKS_FILE ?= "mpfs-rootfs.wks"
```

## meta-mchp-polarfire-soc/meta-mchp-polarfire-soc-bsp/wic/mpfs-initramfs.wks
```
# short-description: Create disk image for Polarfire SoC with u-boot tftp file /u-boot/linux FITImage

part /boot --source bootimg-partition --ondisk mmcblk0 --fstype=vfat --label boot --active --size=1k --align 4096
part /hssboot --source rawcopy --sourceparams="file=payload.bin" --ondisk mmcblk0 --fixed-size 8M --align 1 --align 1 --part-type 21686148-6449-6E6F-744E-656564454649

bootloader --ptable gpt
```

## meta-mchp-polarfire-soc/meta-mchp-polarfire-soc-community/conf/layer.conf
```bitbake
# We have a conf and classes directory, add to BBPATH
BBPATH .= ":${LAYERDIR}"

# We have recipes-* directories, add to BBFILES
BBFILES += "${LAYERDIR}/recipes-*/*/*.bb \
            ${LAYERDIR}/recipes-*/*/*.bbappend"

BBFILE_COLLECTIONS += "meta-mchp-polarfire-soc-community"
BBFILE_PATTERN_meta-mchp-polarfire-soc-community = "^${LAYERDIR}/"
BBFILE_PRIORITY_meta-mchp-polarfire-soc-community = "6"

LAYERDEPENDS_meta-mchp-polarfire-soc-community += "meta-mchp-polarfire-soc-bsp"
LAYERSERIES_COMPAT_meta-mchp-polarfire-soc-community = "scarthgap styhead"
```

## meta-mchp-polarfire-soc/meta-mchp-polarfire-soc-community/conf/machine/beaglev-fire.conf
```bitbake
#@TYPE: Machine
#@NAME: beaglev-fire
#@SOC: beaglev-fire
#@DESCRIPTION: Machine configuration for the BeagleV Fire board

require conf/machine/include/mpfs-common.inc

MACHINE_TYPE = "smp"

RISCV_SBI_FDT ?= "mpfs-beaglev-fire.dtb"
KERNEL_DTC_FLAGS += "-@"
KERNEL_DEVICETREE ?= "microchip/${RISCV_SBI_FDT}"

UBOOT_MACHINE = "beaglev_fire_defconfig"

IMAGE_INSTALL:remove = " dt-overlay-mchp"

UBOOT_ENV = "boot"
UBOOT_ENV_SUFFIX = "scr"
UBOOT_ENV_SIZE = "0x2000"

HSS_PAYLOAD = "uboot"

IMAGE_BOOT_FILES ?= " \
    fitImage \
    boot.scr \
    uboot.env \
"

WKS_FILE ?= "mpfs-rootfs.wks"
```
