## meta-mchp-polarfire-soc/meta-mchp-polarfire-soc-community/conf/machine/m100pfsevp.conf
```bitbake
#@TYPE: Machine
#@NAME: m100pfsevp
#@SOC: Polarfire SoC
#@DESCRIPTION: Machine configuration for the Aries M100PFSEVP PolarFire SoC-FPGA Platform

require conf/machine/include/riscv/tune-riscv.inc

MACHINE_FEATURES = "screen keyboard ext2 ext3 serial"
MACHINE_TYPE = "smp"

KERNEL_CLASSES = "kernel-fitimage"
KERNEL_IMAGETYPE = "fitImage"

KERNEL_DEVICETREE ?= "microchip/mpfs-m100pfsevp-sdcard.dtb microchip/mpfs-m100pfsevp-emmc.dtb"
EXTERNAL_KERNEL_DEVICETREE = "${DEPLOY_DIR_IMAGE}/overlays"
KBUILD_DEFCONFIG ?= "mpfs_defconfig"
PREFERRED_PROVIDER_virtual/kernel ?= "linux-mchp"
PREFERRED_VERSION_linux-mchp = "6.6%"

PREFERRED_VERSION_openocd-native = "riscv"
PREFERRED_VERSION_openocd = "riscv"

UBOOT_MACHINE="m100pfsevp_defconfig"
PREFERRED_PROVIDER_virtual/bootloader = "u-boot-mchp"
PREFERRED_PROVIDER_u-boot = "u-boot-mchp"
PREFERRED_VERSION_u-boot-mchp = "v2023.07%"

UBOOT_ENTRYPOINT = "0x80200000"
UBOOT_DTB_LOADADDRESS = "0x82200000"
UBOOT_DTBO_LOADADDRESS = "0x10 0x02300000"

## Set this to "mmc-tftp" to generate a boot.scr file which should be included
##  in the boot partition. It will try to load a kernel image from mmc and fall back to tftp
## UBOOT_ENV = "mmc-tftp"

HSS_PAYLOAD = "uboot"

MACHINE_EXTRA_RRECOMMENDS += " kernel-modules"

IMAGE_FSTYPES += "wic wic.gz ext4 wic.bmap ext4 tar.xz"

## Do not update fstab file when using wic images
WIC_CREATE_EXTRA_ARGS ?= "--no-fstab-update"

## wic default support
WKS_FILE_DEPENDS ?= " \
    e2fsprogs-native \
    bmaptool-native \
    u-boot-mchp \
"

IMAGE_BOOT_FILES ?= " \
    fitImage \
"

WKS_FILE ?= "m100pfsevp.wks"
```

## meta-mchp-polarfire-soc/meta-mchp-polarfire-soc-community/wic/m100pfsevp.wks
```
# short-description: Create disk image for Polarfire SoC with u-boot tftp file /u-boot/linux FITImage

part /boot --source bootimg-partition --ondisk mmcblk0 --fstype=vfat --label boot --active --size=1k --align 4096
part /hssboot --source rawcopy --sourceparams="file=payload.bin" --ondisk mmcblk0 --fixed-size 8M --align 1 --align 1 --part-type 21686148-6449-6E6F-744E-656564454649
part / --source rootfs --ondisk mmcblk0 --fstype=ext4 --label root --align 4096 --size 10M


bootloader --ptable gpt
```

## recipes-kernel/linux/files/sama5d3xek/sama5d3xek.its
```
/*
 * Simple U-boot uImage source file containing a single kernel and FDT blob
 */

/dts-v1/;
/include/ "sama5d3xek_pda4.its"
/include/ "sama5d3xek_pda7.its"

/ {
	description = "Simple image with single Linux kernel and FDT blob";
	#address-cells = <1>;

	images {
		kernel@1 {
			description = "AT91 SAMA5D3 Linux kernel";
			data = /incbin/("../zImage");
			type = "kernel";
			arch = "arm";
			os = "linux";
			compression = "none";
			load = <0x20008000>;
			entry = <0x20008000>;
			hash@1 {
				algo = "crc32";
			};
		};
		fdt_sama5d31ek@1 {
			description = "Flattened Device Tree blob for SAMA5D31EK";
			data = /incbin/("./sama5d31ek.dtb");
			type = "flat_dt";
			arch = "arm";
			compression = "none";
			hash@1 {
				algo = "crc32";
			};
		};
		fdt_sama5d33ek@1 {
			description = "Flattened Device Tree blob for SAMA5D33EK";
			data = /incbin/("./sama5d33ek.dtb");
			type = "flat_dt";
			arch = "arm";
			compression = "none";
			hash@1 {
				algo = "crc32";
			};
		};
		fdt_sama5d34ek@1 {
			description = "Flattened Device Tree blob for SAMA5D34EK";
			data = /incbin/("./sama5d34ek.dtb");
			type = "flat_dt";
			arch = "arm";
			compression = "none";
			hash@1 {
				algo = "crc32";
			};
		};
		fdt_sama5d35ek@1 {
			description = "Flattened Device Tree blob for SAMA5D35EK";
			data = /incbin/("./sama5d35ek.dtb");
			type = "flat_dt";
			arch = "arm";
			compression = "none";
			hash@1 {
				algo = "crc32";
			};
		};
		fdt_sama5d36ek@1 {
			description = "Flattened Device Tree blob for SAMA5D36EK";
			data = /incbin/("./sama5d36ek.dtb");
			type = "flat_dt";
			arch = "arm";
			compression = "none";
			hash@1 {
				algo = "crc32";
			};
		};

		/* rev.C MB */
		fdt_sama5d31ek_revc@1 {
			description = "Flattened Device Tree blob for SAMA5D31EK rev.C";
			data = /incbin/("./sama5d31ek_revc.dtb");
			type = "flat_dt";
			arch = "arm";
			compression = "none";
			hash@1 {
				algo = "crc32";
			};
		};
		fdt_sama5d33ek_revc@1 {
			description = "Flattened Device Tree blob for SAMA5D33EK rev.C";
			data = /incbin/("./sama5d33ek_revc.dtb");
			type = "flat_dt";
			arch = "arm";
			compression = "none";
			hash@1 {
				algo = "crc32";
			};
		};
		fdt_sama5d34ek_revc@1 {
			description = "Flattened Device Tree blob for SAMA5D34EK rev.C";
			data = /incbin/("./sama5d34ek_revc.dtb");
			type = "flat_dt";
			arch = "arm";
			compression = "none";
			hash@1 {
				algo = "crc32";
			};
		};
		fdt_sama5d35ek_revc@1 {
			description = "Flattened Device Tree blob for SAMA5D35EK rev.C";
			data = /incbin/("./sama5d35ek_revc.dtb");
			type = "flat_dt";
			arch = "arm";
			compression = "none";
			hash@1 {
				algo = "crc32";
			};
		};
		fdt_sama5d36ek_revc@1 {
			description = "Flattened Device Tree blob for SAMA5D36EK rev.C";
			data = /incbin/("./sama5d36ek_revc.dtb");
			type = "flat_dt";
			arch = "arm";
			compression = "none";
			hash@1 {
				algo = "crc32";
			};
		};
	};

	configurations {
		default = "conf@sama5d34ek";

		conf@sama5d31ek {
			description = "Boot Linux kernel with SAMA5D31EK FDT blob";
			kernel = "kernel@1";
			fdt = "fdt_sama5d31ek@1";
		};
		conf@sama5d33ek {
			description = "Boot Linux kernel with SAMA5D33EK FDT blob";
			kernel = "kernel@1";
			fdt = "fdt_sama5d33ek@1";
		};
		conf@sama5d34ek {
			description = "Boot Linux kernel with SAMA5D34EK FDT blob";
			kernel = "kernel@1";
			fdt = "fdt_sama5d34ek@1";
		};
		conf@sama5d35ek {
			description = "Boot Linux kernel with SAMA5D35EK FDT blob";
			kernel = "kernel@1";
			fdt = "fdt_sama5d35ek@1";
		};
		conf@sama5d36ek {
			description = "Boot Linux kernel with SAMA5D36EK FDT blob";
			kernel = "kernel@1";
			fdt = "fdt_sama5d36ek@1";
		};

		/* rev.C MB */
		conf@sama5d31ek_revc {
			description = "Boot Linux kernel with SAMA5D31EK rev.C FDT blob";
			kernel = "kernel@1";
			fdt = "fdt_sama5d31ek_revc@1";
		};
		conf@sama5d33ek_revc {
			description = "Boot Linux kernel with SAMA5D33EK rev.C FDT blob";
			kernel = "kernel@1";
			fdt = "fdt_sama5d33ek_revc@1";
		};
		conf@sama5d34ek_revc {
			description = "Boot Linux kernel with SAMA5D34EK rev.C FDT blob";
			kernel = "kernel@1";
			fdt = "fdt_sama5d34ek_revc@1";
		};
		conf@sama5d35ek_revc {
			description = "Boot Linux kernel with SAMA5D35EK rev.C FDT blob";
			kernel = "kernel@1";
			fdt = "fdt_sama5d35ek_revc@1";
		};
		conf@sama5d36ek_revc {
			description = "Boot Linux kernel with SAMA5D36EK rev.C FDT blob";
			kernel = "kernel@1";
			fdt = "fdt_sama5d36ek_revc@1";
		};
	};
};
```
